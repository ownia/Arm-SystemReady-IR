## tool/ir_2/test.its
```
/dts-v1/;

/ {
     description = "Automatic U-Boot update";
     \#address-cells = <1>;

     images {
             idbloader.img {
                     description = "pre-loader binary";
                     data = /incbin/("idbloader.img");
                     compression = "none";
                     type = "firmware";
                     arch = "arm64";
                     load = <0x0>;

                     hash-1 {
                             algo = "sha1";
                     };
             };
             u-boot.itb {
                     description = "U-Boot binary";
                     data = /incbin/("u-boot.itb");
                     compression = "none";
                     type = "firmware";
                     arch = "arm64";
                     load = <0x0>;

                     hash-1 {
                             algo = "sha1";
                     };
             };
     };
};
```
