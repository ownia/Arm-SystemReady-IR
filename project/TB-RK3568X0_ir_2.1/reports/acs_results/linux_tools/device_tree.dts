/dts-v1/;

/ {
	#address-cells = <0x02>;
	model = "Toybrick TB-RK3568X";
	serial-number = "4260764582e7aaee";
	#size-cells = <0x02>;
	interrupt-parent = <0x01>;
	compatible = "rockchip,rk3568-toybrick\0rockchip,rk3568";

	mipi-dphy@fe860000 {
		power-domains = <0x10 0x09>;
		clock-names = "ref\0pclk";
		resets = <0x0e 0x1bc>;
		clocks = <0x1e 0x19 0x0e 0x17b>;
		#phy-cells = <0x00>;
		compatible = "rockchip,rk3568-dsi-dphy";
		status = "disabled";
		reg = <0x00 0xfe860000 0x00 0x10000>;
		phandle = <0x56>;
		reset-names = "apb";
	};

	spi@fe620000 {
		pinctrl-names = "default";
		#address-cells = <0x01>;
		pinctrl-0 = <0x88 0x89 0x8a>;
		clock-names = "spiclk\0apb_pclk";
		interrupts = <0x00 0x68 0x04>;
		clocks = <0x0e 0x154 0x0e 0x153>;
		#size-cells = <0x00>;
		dma-names = "tx\0rx";
		compatible = "rockchip,rk3568-spi\0rockchip,rk3066-spi";
		status = "disabled";
		reg = <0x00 0xfe620000 0x00 0x1000>;
		phandle = <0x119>;
		dmas = <0x25 0x16 0x25 0x17>;
	};

	qos@fe158300 {
		compatible = "rockchip,rk3568-qos\0syscon";
		reg = <0x00 0xfe158300 0x00 0x20>;
		phandle = <0x37>;
	};

	syscon@fdc20000 {
		bootph-all;
		compatible = "rockchip,rk3568-pmugrf\0syscon\0simple-mfd";
		status = "okay";
		reg = <0x00 0xfdc20000 0x00 0x10000>;
		phandle = <0xb4>;

		io-domains {
			vccio1-supply = <0x18>;
			vccio2-supply = <0x19>;
			vccio3-supply = <0x1a>;
			vccio4-supply = <0x19>;
			pmuio1-supply = <0x17>;
			vccio5-supply = <0x1b>;
			pmuio2-supply = <0x17>;
			vccio6-supply = <0x19>;
			vccio7-supply = <0x1b>;
			compatible = "rockchip,rk3568-pmu-io-voltage-domain";
			status = "okay";
			phandle = <0xe6>;
		};
	};

	i2c@fe5c0000 {
		pinctrl-names = "default";
		#address-cells = <0x01>;
		pinctrl-0 = <0x82>;
		clock-names = "i2c\0pclk";
		interrupts = <0x00 0x31 0x04>;
		clocks = <0x0e 0x14c 0x0e 0x14b>;
		#size-cells = <0x00>;
		compatible = "rockchip,rk3568-i2c\0rockchip,rk3399-i2c";
		status = "disabled";
		reg = <0x00 0xfe5c0000 0x00 0x1000>;
		phandle = <0x114>;
	};

	gpu@fde60000 {
		power-domains = <0x10 0x07>;
		mali-supply = <0x46>;
		clock-names = "gpu\0bus";
		interrupts = <0x00 0x28 0x04 0x00 0x29 0x04 0x00 0x27 0x04>;
		clocks = <0x02 0x01 0x0e 0x1b>;
		compatible = "rockchip,rk3568-mali\0arm,mali-bifrost";
		status = "okay";
		interrupt-names = "job\0mmu\0gpu";
		reg = <0x00 0xfde60000 0x00 0x4000>;
		phandle = <0x9d>;
		operating-points-v2 = <0x45>;
		#cooling-cells = <0x02>;
	};

	opp-table-1 {
		compatible = "operating-points-v2";
		phandle = <0x45>;

		opp-300000000 {
			opp-microvolt = <0xc96a8>;
			opp-hz = <0x00 0x11e1a300>;
		};

		opp-700000000 {
			opp-microvolt = <0xdbba0>;
			opp-hz = <0x00 0x29b92700>;
		};

		opp-200000000 {
			opp-microvolt = <0xc96a8>;
			opp-hz = <0x00 0xbebc200>;
		};

		opp-400000000 {
			opp-microvolt = <0xc96a8>;
			opp-hz = <0x00 0x17d78400>;
		};

		opp-600000000 {
			opp-microvolt = <0xc96a8>;
			opp-hz = <0x00 0x23c34600>;
		};

		opp-800000000 {
			opp-microvolt = <0xf4240>;
			opp-hz = <0x00 0x2faf0800>;
		};
	};

	spdif@fe460000 {
		pinctrl-names = "default";
		pinctrl-0 = <0x7c>;
		clock-names = "mclk\0hclk";
		interrupts = <0x00 0x66 0x04>;
		clocks = <0x0e 0x5f 0x0e 0x5c>;
		dma-names = "tx";
		#sound-dai-cells = <0x00>;
		compatible = "rockchip,rk3568-spdif";
		status = "disabled";
		reg = <0x00 0xfe460000 0x00 0x1000>;
		phandle = <0x110>;
		dmas = <0x65 0x01>;
	};

	qos@fe1a8100 {
		compatible = "rockchip,rk3568-qos\0syscon";
		reg = <0x00 0xfe1a8100 0x00 0x20>;
		phandle = <0x31>;
	};

	syscon@fdc60000 {
		bootph-all;
		compatible = "rockchip,rk3568-grf\0syscon\0simple-mfd";
		status = "okay";
		reg = <0x00 0xfdc60000 0x00 0x10000>;
		phandle = <0x1c>;
	};

	pinctrl {
		#address-cells = <0x02>;
		bootph-all;
		#size-cells = <0x02>;
		compatible = "rockchip,rk3568-pinctrl";
		rockchip,pmu = <0xb4>;
		ranges;
		status = "okay";
		rockchip,grf = <0x1c>;
		phandle = <0xb5>;

		eth0 {
		};

		i2c3 {

			i2c3m0-xfer {
				rockchip,pins = <0x01 0x01 0x01 0xbb 0x01 0x00 0x01 0xbb>;
				phandle = <0x82>;
			};
		};

		pwm9 {

			pwm9m0-pins {
				rockchip,pins = <0x03 0x0a 0x05 0xb6>;
				phandle = <0xa6>;
			};
		};

		pwm14 {

			pwm14m0-pins {
				rockchip,pins = <0x03 0x14 0x01 0xb6>;
				phandle = <0xab>;
			};
		};

		npu {
		};

		pcie30x1 {
		};

		gpio@fdd60000 {
			gpio-controller;
			interrupts = <0x00 0x21 0x04>;
			clocks = <0x1e 0x2e 0x1e 0x0c>;
			compatible = "rockchip,gpio-bank";
			#interrupt-cells = <0x02>;
			reg = <0x00 0xfdd60000 0x00 0x100>;
			phandle = <0x21>;
			#gpio-cells = <0x02>;
			gpio-ranges = <0xb5 0x00 0x00 0x20>;
			interrupt-controller;
		};

		uart8 {

			uart8m0-xfer {
				rockchip,pins = <0x02 0x16 0x02 0xb8 0x02 0x15 0x03 0xb8>;
				phandle = <0x98>;
			};
		};

		gmac-txc-level2 {
		};

		spi2 {

			spi2m0-cs1 {
				rockchip,pins = <0x02 0x15 0x04 0xb6>;
				phandle = <0x8c>;
			};

			spi2m0-cs0 {
				rockchip,pins = <0x02 0x14 0x04 0xb6>;
				phandle = <0x8b>;
			};

			spi2m0-pins {
				rockchip,pins = <0x02 0x11 0x04 0xb6 0x02 0x12 0x04 0xb6 0x02 0x13 0x04 0xb6>;
				phandle = <0x8d>;
			};
		};

		pcfg-pull-up-drv-level-2 {
			bootph-all;
			drive-strength = <0x02>;
			phandle = <0xb7>;
			bias-pull-up;
		};

		i2s1 {

			i2s1m0-sdo1 {
				rockchip,pins = <0x01 0x08 0x01 0xb6>;
				phandle = <0x6f>;
			};

			i2s1m0-lrcktx {
				rockchip,pins = <0x01 0x05 0x01 0xb6>;
				phandle = <0x68>;
			};

			i2s1m0-lrckrx {
				rockchip,pins = <0x01 0x06 0x01 0xb6>;
				phandle = <0x69>;
			};

			i2s1m0-sdi3 {
				rockchip,pins = <0x01 0x08 0x02 0xb6>;
				phandle = <0x6d>;
			};

			i2s1m0-mclk {
				rockchip,pins = <0x01 0x02 0x01 0xb6>;
				phandle = <0x23>;
			};

			i2s1m0-sclktx {
				rockchip,pins = <0x01 0x03 0x01 0xb6>;
				phandle = <0x66>;
			};

			i2s1m0-sdi1 {
				rockchip,pins = <0x01 0x0a 0x02 0xb6>;
				phandle = <0x6b>;
			};

			i2s1m0-sclkrx {
				rockchip,pins = <0x01 0x04 0x01 0xb6>;
				phandle = <0x67>;
			};

			i2s1m0-sdo2 {
				rockchip,pins = <0x01 0x09 0x01 0xb6>;
				phandle = <0x70>;
			};

			i2s1m0-sdo0 {
				rockchip,pins = <0x01 0x07 0x01 0xb6>;
				phandle = <0x6e>;
			};

			i2s1m0-sdi2 {
				rockchip,pins = <0x01 0x09 0x02 0xb6>;
				phandle = <0x6c>;
			};

			i2s1m0-sdi0 {
				rockchip,pins = <0x01 0x0b 0x01 0xb6>;
				phandle = <0x6a>;
			};

			i2s1m0-sdo3 {
				rockchip,pins = <0x01 0x0a 0x01 0xb6>;
				phandle = <0x71>;
			};
		};

		pdm {

			pdmm0-sdi3 {
				rockchip,pins = <0x01 0x08 0x03 0xb6>;
				phandle = <0x7b>;
			};

			pdmm0-sdi1 {
				rockchip,pins = <0x01 0x0a 0x03 0xb6>;
				phandle = <0x79>;
			};

			pdmm0-clk1 {
				rockchip,pins = <0x01 0x04 0x03 0xb6>;
				phandle = <0x77>;
			};

			pdmm0-sdi2 {
				rockchip,pins = <0x01 0x09 0x03 0xb6>;
				phandle = <0x7a>;
			};

			pdmm0-sdi0 {
				rockchip,pins = <0x01 0x0b 0x02 0xb6>;
				phandle = <0x78>;
			};

			pdmm0-clk {
				rockchip,pins = <0x01 0x06 0x03 0xb6>;
				phandle = <0x76>;
			};
		};

		gpio@fe770000 {
			gpio-controller;
			interrupts = <0x00 0x25 0x04>;
			clocks = <0x0e 0x169 0x0e 0x16a>;
			compatible = "rockchip,gpio-bank";
			#interrupt-cells = <0x02>;
			reg = <0x00 0xfe770000 0x00 0x100>;
			phandle = <0x13b>;
			#gpio-cells = <0x02>;
			gpio-ranges = <0xb5 0x00 0x80 0x20>;
			interrupt-controller;
		};

		i2c1 {

			i2c1-xfer {
				rockchip,pins = <0x00 0x0b 0x01 0xbb 0x00 0x0c 0x01 0xbb>;
				phandle = <0x7d>;
			};
		};

		pwm7 {

			pwm7-pins {
				rockchip,pins = <0x00 0x16 0x01 0xb6>;
				phandle = <0xa4>;
			};
		};

		gmac0 {

			gmac0-miim {
				rockchip,pins = <0x02 0x13 0x02 0xb6 0x02 0x14 0x02 0xb6>;
				phandle = <0xc6>;
			};

			gmac0-tx-bus2 {
				rockchip,pins = <0x02 0x0b 0x01 0xb9 0x02 0x0c 0x01 0xb9 0x02 0x0d 0x01 0xb6>;
				phandle = <0xc7>;
			};

			gmac0-rgmii-bus {
				rockchip,pins = <0x02 0x03 0x02 0xb6 0x02 0x04 0x02 0xb6 0x02 0x06 0x02 0xb9 0x02 0x07 0x02 0xb9>;
				phandle = <0xca>;
			};

			gmac0-rx-bus2 {
				rockchip,pins = <0x02 0x0e 0x01 0xb6 0x02 0x0f 0x02 0xb6 0x02 0x10 0x02 0xb6>;
				phandle = <0xc8>;
			};

			gmac0-rgmii-clk {
				rockchip,pins = <0x02 0x05 0x02 0xb6 0x02 0x08 0x02 0xba>;
				phandle = <0xc9>;
			};
		};

		pwm12 {

			pwm12m0-pins {
				rockchip,pins = <0x03 0x0f 0x02 0xb6>;
				phandle = <0xa9>;
			};
		};

		uart6 {

			uart6m0-xfer {
				rockchip,pins = <0x02 0x03 0x03 0xb8 0x02 0x04 0x03 0xb8>;
				phandle = <0x96>;
			};
		};

		gpu {
		};

		spi0 {

			spi0m0-cs0 {
				rockchip,pins = <0x00 0x16 0x02 0xb6>;
				phandle = <0x85>;
			};

			spi0m0-cs1 {
				rockchip,pins = <0x00 0x14 0x02 0xb6>;
				phandle = <0x86>;
			};

			spi0m0-pins {
				rockchip,pins = <0x00 0x0d 0x02 0xb6 0x00 0x15 0x02 0xb6 0x00 0x0e 0x02 0xb6>;
				phandle = <0x87>;
			};
		};

		fspi {

			fspi-pins {
				bootph-all;
				rockchip,pins = <0x01 0x18 0x01 0xb6 0x01 0x1b 0x01 0xb6 0x01 0x19 0x01 0xb6 0x01 0x1a 0x01 0xb6 0x01 0x17 0x02 0xb6 0x01 0x1c 0x01 0xb6>;
				phandle = <0x64>;
			};
		};

		clk32k {

			clk32k-out0 {
				rockchip,pins = <0x00 0x08 0x02 0xb6>;
				phandle = <0x0d>;
			};
		};

		ebc {
		};

		spi2-hs {
		};

		pwm5 {

			pwm5-pins {
				rockchip,pins = <0x00 0x14 0x01 0xb6>;
				phandle = <0xa2>;
			};
		};

		pcfg-pull-none-drv-level-3 {
			drive-strength = <0x03>;
			bias-disable;
			phandle = <0xbd>;
		};

		isp {
		};

		pwm10 {

			pwm10m0-pins {
				rockchip,pins = <0x03 0x0d 0x05 0xb6>;
				phandle = <0xa7>;
			};
		};

		uart4 {

			uart4m0-xfer {
				rockchip,pins = <0x01 0x04 0x02 0xb8 0x01 0x06 0x02 0xb8>;
				phandle = <0x94>;
			};
		};

		mcu {
		};

		pwm3 {

			pwm3-pins {
				rockchip,pins = <0x00 0x12 0x01 0xb6>;
				phandle = <0x2a>;
			};
		};

		pcfg-pull-none-drv-level-1 {
			drive-strength = <0x01>;
			bias-disable;
			phandle = <0xba>;
		};

		sata2 {
		};

		gpio@fe740000 {
			gpio-controller;
			interrupts = <0x00 0x22 0x04>;
			clocks = <0x0e 0x163 0x0e 0x164>;
			compatible = "rockchip,gpio-bank";
			#interrupt-cells = <0x02>;
			reg = <0x00 0xfe740000 0x00 0x100>;
			phandle = <0x13a>;
			#gpio-cells = <0x02>;
			gpio-ranges = <0xb5 0x00 0x20 0x20>;
			interrupt-controller;
		};

		cam {
		};

		uart2 {

			uart2m0-xfer {
				bootph-all;
				rockchip,pins = <0x00 0x18 0x01 0xb8 0x00 0x19 0x01 0xb8>;
				phandle = <0x92>;
			};
		};

		touchscreen {

			touch_rst {
				rockchip,pins = <0x00 0x0e 0x00 0xb6>;
				phandle = <0x80>;
			};

			touch_int {
				rockchip,pins = <0x00 0x0d 0x00 0xb8>;
				phandle = <0x7f>;
			};
		};

		display {

			vcc3v3_lcd1_n_en {
				rockchip,pins = <0x00 0x15 0x00 0xb6>;
				phandle = <0xd6>;
			};

			vcc3v3_lcd0_n_en {
				rockchip,pins = <0x00 0x17 0x00 0xb6>;
				phandle = <0xd5>;
			};
		};

		lcdc {
		};

		cpu {
		};

		sdmmc1 {
		};

		leds {

			led_work_en {
				rockchip,pins = <0x00 0x10 0x00 0xb6>;
				phandle = <0xce>;
			};
		};

		pwm1 {

			pwm1m0-pins {
				rockchip,pins = <0x00 0x10 0x01 0xb6>;
				phandle = <0x28>;
			};
		};

		sata0 {
		};

		refclk {
		};

		can2 {
		};

		sata {
		};

		audiopwm {
		};

		edpdp {
		};

		tsadc {

			tsadc-pin {
				rockchip,pins = <0x00 0x01 0x00 0xb6>;
				phandle = <0x9e>;
			};

			tsadc-shutorg {
				rockchip,pins = <0x00 0x01 0x02 0xb6>;
				phandle = <0x9f>;
			};
		};

		uart0 {

			uart0-xfer {
				rockchip,pins = <0x00 0x10 0x03 0xb8 0x00 0x11 0x03 0xb8>;
				phandle = <0x26>;
			};
		};

		eth1 {
		};

		i2c4 {

			i2c4m0-xfer {
				rockchip,pins = <0x04 0x0b 0x01 0xbb 0x04 0x0a 0x01 0xbb>;
				phandle = <0x83>;
			};
		};

		emmc {
		};

		pwm15 {

			pwm15m0-pins {
				rockchip,pins = <0x03 0x15 0x01 0xb6>;
				phandle = <0xac>;
			};
		};

		spdif {

			spdifm0-tx {
				rockchip,pins = <0x01 0x04 0x04 0xb6>;
				phandle = <0x7c>;
			};
		};

		pcie30x2 {
		};

		can0 {
		};

		uart9 {

			uart9m0-xfer {
				rockchip,pins = <0x02 0x07 0x03 0xb8 0x02 0x08 0x03 0xb8>;
				phandle = <0x99>;
			};
		};

		pcfg-pull-up {
			bootph-all;
			phandle = <0xb8>;
			bias-pull-up;
		};

		spi3 {

			spi3m0-cs1 {
				rockchip,pins = <0x04 0x07 0x04 0xb6>;
				phandle = <0x8f>;
			};

			spi3m0-pins {
				rockchip,pins = <0x04 0x0b 0x04 0xb6 0x04 0x08 0x04 0xb6 0x04 0x0a 0x04 0xb6>;
				phandle = <0x90>;
			};

			spi3m0-cs0 {
				rockchip,pins = <0x04 0x06 0x04 0xb6>;
				phandle = <0x8e>;
			};
		};

		spi1-hs {
		};

		bt656 {
		};

		i2s2 {

			i2s2m0-lrcktx {
				rockchip,pins = <0x02 0x13 0x01 0xb6>;
				phandle = <0x73>;
			};

			i2s2m0-sdi {
				rockchip,pins = <0x02 0x15 0x01 0xb6>;
				phandle = <0x74>;
			};

			i2s2m0-sclktx {
				rockchip,pins = <0x02 0x12 0x01 0xb6>;
				phandle = <0x72>;
			};

			i2s2m0-sdo {
				rockchip,pins = <0x02 0x14 0x01 0xb6>;
				phandle = <0x75>;
			};
		};

		i2c2 {

			i2c2m0-xfer {
				rockchip,pins = <0x00 0x0d 0x01 0xbb 0x00 0x0e 0x01 0xbb>;
				phandle = <0x81>;
			};
		};

		gmac-txd-level3 {
		};

		pwm8 {

			pwm8m0-pins {
				rockchip,pins = <0x03 0x09 0x05 0xb6>;
				phandle = <0xa5>;
			};
		};

		pmic {

			pmic_int {
				rockchip,pins = <0x00 0x03 0x00 0xb8>;
				phandle = <0x22>;
			};
		};

		jtag {
		};

		gmac1 {

			gmac1m1-rgmii-clk {
				rockchip,pins = <0x04 0x03 0x03 0xb6 0x04 0x00 0x03 0xba>;
				phandle = <0x50>;
			};

			gmac1m1-miim {
				rockchip,pins = <0x04 0x0e 0x03 0xb6 0x04 0x0f 0x03 0xb6>;
				phandle = <0x4d>;
			};

			gmac1m1-tx-bus2 {
				rockchip,pins = <0x04 0x04 0x03 0xb9 0x04 0x05 0x03 0xb9 0x04 0x06 0x03 0xb6>;
				phandle = <0x4e>;
			};

			gmac1m1-rgmii-bus {
				rockchip,pins = <0x04 0x01 0x03 0xb6 0x04 0x02 0x03 0xb6 0x03 0x1e 0x03 0xb9 0x03 0x1f 0x03 0xb9>;
				phandle = <0x51>;
			};

			gmac1m1-rx-bus2 {
				rockchip,pins = <0x04 0x07 0x03 0xb6 0x04 0x08 0x03 0xb6 0x04 0x09 0x03 0xb6>;
				phandle = <0x4f>;
			};
		};

		pcfg-pull-none {
			bootph-all;
			bias-disable;
			phandle = <0xb6>;
		};

		pwm13 {

			pwm13m0-pins {
				rockchip,pins = <0x03 0x10 0x02 0xb6>;
				phandle = <0xaa>;
			};
		};

		acodec {
		};

		gpio@fe750000 {
			gpio-controller;
			interrupts = <0x00 0x23 0x04>;
			clocks = <0x0e 0x165 0x0e 0x166>;
			compatible = "rockchip,gpio-bank";
			#interrupt-cells = <0x02>;
			reg = <0x00 0xfe750000 0x00 0x100>;
			phandle = <0x4c>;
			#gpio-cells = <0x02>;
			gpio-ranges = <0xb5 0x00 0x40 0x20>;
			interrupt-controller;
		};

		uart7 {

			uart7m0-xfer {
				rockchip,pins = <0x02 0x05 0x03 0xb8 0x02 0x06 0x03 0xb8>;
				phandle = <0x97>;
			};
		};

		spi1 {

			spi1m0-cs0 {
				rockchip,pins = <0x02 0x10 0x04 0xb6>;
				phandle = <0x88>;
			};

			spi1m0-pins {
				rockchip,pins = <0x02 0x0d 0x03 0xb6 0x02 0x0e 0x03 0xb6 0x02 0x0f 0x04 0xb6>;
				phandle = <0x8a>;
			};

			spi1m0-cs1 {
				rockchip,pins = <0x02 0x16 0x03 0xb6>;
				phandle = <0x89>;
			};
		};

		sdio-pwrseq {

			wifi-enable-h {
				rockchip,pins = <0x03 0x1d 0x00 0xb6>;
				phandle = <0xd7>;
			};
		};

		usb {

			vcc5v0_usb_host_en {
				rockchip,pins = <0x00 0x06 0x00 0xb6>;
				phandle = <0xd2>;
			};

			vcc5v0_usb_otg_en {
				rockchip,pins = <0x00 0x05 0x00 0xb6>;
				phandle = <0xd4>;
			};
		};

		pcfg-pull-up-drv-level-1 {
			drive-strength = <0x01>;
			phandle = <0xbc>;
			bias-pull-up;
		};

		pcfg-pull-none-smt {
			bootph-all;
			bias-disable;
			input-schmitt-enable;
			phandle = <0xbb>;
		};

		i2c0 {

			i2c0-xfer {
				bootph-all;
				rockchip,pins = <0x00 0x09 0x01 0xbb 0x00 0x0a 0x01 0xbb>;
				phandle = <0x1f>;
			};
		};

		pwm6 {

			pwm6-pins {
				rockchip,pins = <0x00 0x15 0x01 0xb6>;
				phandle = <0xa3>;
			};
		};

		pwm11 {

			pwm11m0-pins {
				rockchip,pins = <0x03 0x0e 0x05 0xb6>;
				phandle = <0xa8>;
			};
		};

		bt1120 {
		};

		uart5 {

			uart5m0-xfer {
				rockchip,pins = <0x02 0x01 0x03 0xb8 0x02 0x02 0x03 0xb8>;
				phandle = <0x95>;
			};
		};

		flash {
		};

		vop {
		};

		pwm4 {

			pwm4-pins {
				rockchip,pins = <0x00 0x13 0x01 0xb6>;
				phandle = <0xa1>;
			};
		};

		pcfg-pull-none-drv-level-2 {
			drive-strength = <0x02>;
			bias-disable;
			phandle = <0xb9>;
		};

		uart3 {

			uart3m0-xfer {
				rockchip,pins = <0x01 0x00 0x02 0xb8 0x01 0x01 0x02 0xb8>;
				phandle = <0x93>;
			};
		};

		hdmitx {

			hdmitx-scl {
				rockchip,pins = <0x04 0x17 0x01 0xb6>;
				phandle = <0x57>;
			};

			hdmitx-sda {
				rockchip,pins = <0x04 0x18 0x01 0xb6>;
				phandle = <0x58>;
			};

			hdmitxm0-cec {
				rockchip,pins = <0x04 0x19 0x01 0xb6>;
				phandle = <0x59>;
			};
		};

		sdmmc2 {
		};

		gpio@fe760000 {
			gpio-controller;
			interrupts = <0x00 0x24 0x04>;
			clocks = <0x0e 0x167 0x0e 0x168>;
			compatible = "rockchip,gpio-bank";
			#interrupt-cells = <0x02>;
			reg = <0x00 0xfe760000 0x00 0x100>;
			phandle = <0xd8>;
			#gpio-cells = <0x02>;
			gpio-ranges = <0xb5 0x00 0x60 0x20>;
			interrupt-controller;
		};

		spi3-hs {
		};

		pwm2 {

			pwm2m0-pins {
				rockchip,pins = <0x00 0x11 0x01 0xb6>;
				phandle = <0x29>;
			};
		};

		sata1 {
		};

		spi0-hs {
		};

		pmu {
		};

		scr {
		};

		uart1 {

			uart1m0-xfer {
				rockchip,pins = <0x02 0x0b 0x02 0xb8 0x02 0x0c 0x02 0xb8>;
				phandle = <0x91>;
			};
		};

		i2c5 {

			i2c5m0-xfer {
				rockchip,pins = <0x03 0x0b 0x04 0xbb 0x03 0x0c 0x04 0xbb>;
				phandle = <0x84>;
			};
		};

		sdmmc0 {

			sdmmc0-det {
				bootph-all;
				rockchip,pins = <0x00 0x04 0x01 0xb8>;
				phandle = <0x62>;
			};

			sdmmc0-bus4 {
				bootph-all;
				rockchip,pins = <0x01 0x1d 0x01 0xb7 0x01 0x1e 0x01 0xb7 0x01 0x1f 0x01 0xb7 0x02 0x00 0x01 0xb7>;
				phandle = <0x5f>;
			};

			sdmmc0-cmd {
				bootph-all;
				rockchip,pins = <0x02 0x01 0x01 0xb7>;
				phandle = <0x61>;
			};

			sdmmc0-clk {
				bootph-all;
				rockchip,pins = <0x02 0x02 0x01 0xb7>;
				phandle = <0x60>;
			};
		};

		pwm0 {

			pwm0m0-pins {
				rockchip,pins = <0x00 0x0f 0x01 0xb6>;
				phandle = <0x27>;
			};
		};

		cif {
		};

		can1 {
		};

		pcie20 {
		};

		i2s3 {
		};
	};

	qos@fe190200 {
		compatible = "rockchip,rk3568-qos\0syscon";
		reg = <0x00 0xfe190200 0x00 0x20>;
		phandle = <0x40>;
	};

	mmc@fe2c0000 {
		fifo-depth = <0x100>;
		clock-names = "biu\0ciu\0ciu-drive\0ciu-sample";
		resets = <0x0e 0xd6>;
		interrupts = <0x00 0x63 0x04>;
		clocks = <0x0e 0xb2 0x0e 0xb3 0x0e 0x18c 0x0e 0x18d>;
		compatible = "rockchip,rk3568-dw-mshc\0rockchip,rk3288-dw-mshc";
		status = "okay";
		reg = <0x00 0xfe2c0000 0x00 0x4000>;
		phandle = <0x108>;
		max-frequency = <0x8f0d180>;
		reset-names = "reset";
	};

	qos@fe158280 {
		compatible = "rockchip,rk3568-qos\0syscon";
		reg = <0x00 0xfe158280 0x00 0x20>;
		phandle = <0x36>;
	};

	serial@fe6a0000 {
		reg-io-width = <0x04>;
		pinctrl-names = "default";
		pinctrl-0 = <0x96>;
		clock-names = "baudclk\0apb_pclk";
		interrupts = <0x00 0x7a 0x04>;
		clocks = <0x0e 0x133 0x0e 0x130>;
		compatible = "rockchip,rk3568-uart\0snps,dw-apb-uart";
		status = "disabled";
		reg = <0x00 0xfe6a0000 0x00 0x100>;
		phandle = <0x121>;
		dmas = <0x25 0x0c 0x25 0x0d>;
		reg-shift = <0x02>;
	};

	qos@fe138100 {
		compatible = "rockchip,rk3568-qos\0syscon";
		reg = <0x00 0xfe138100 0x00 0x20>;
		phandle = <0x3b>;
	};

	interrupt-controller@fd400000 {
		mbi-ranges = <0x128 0x18>;
		interrupts = <0x01 0x09 0x04>;
		msi-controller;
		mbi-alias = <0x00 0xfd410000>;
		compatible = "arm,gic-v3";
		#interrupt-cells = <0x03>;
		reg = <0x00 0xfd400000 0x00 0x10000 0x00 0xfd460000 0x00 0x80000>;
		phandle = <0x01>;
		interrupt-controller;
	};

	i2s@fe430000 {
		clock-names = "mclk_tx\0mclk_rx\0hclk";
		resets = <0x0e 0x55 0x0e 0x56>;
		interrupts = <0x00 0x37 0x04>;
		clocks = <0x0e 0x53 0x0e 0x57 0x0e 0x3c>;
		dma-names = "tx\0rx";
		#sound-dai-cells = <0x00>;
		compatible = "rockchip,rk3568-i2s-tdm";
		status = "disabled";
		rockchip,grf = <0x1c>;
		reg = <0x00 0xfe430000 0x00 0x1000>;
		phandle = <0x10e>;
		dmas = <0x65 0x06 0x65 0x07>;
		reset-names = "tx-m\0rx-m";
	};

	signature {
		capsule-key = [a1 59 c0 a5 e4 94 a7 4a 87 b5 ab 15 5c 2b f0 72 2d 03 00 00 00 00 00 00 11 03 00 00 00 00 00 00 00 00 00 00 00 00 00 00 00 00 00 00 30 82 02 fd 30 82 01 e5 a0 03 02 01 02 02 14 15 18 45 5f 1b 38 7f e4 a5 80 af 41 5e 9c 7c f5 86 35 ac bb 30 0d 06 09 2a 86 48 86 f7 0d 01 01 0b 05 00 30 0e 31 0c 30 0a 06 03 55 04 03 0c 03 43 52 54 30 1e 17 0d 32 33 31 31 30 32 30 37 31 36 35 39 5a 17 0d 32 34 31 31 30 31 30 37 31 36 35 39 5a 30 0e 31 0c 30 0a 06 03 55 04 03 0c 03 43 52 54 30 82 01 22 30 0d 06 09 2a 86 48 86 f7 0d 01 01 01 05 00 03 82 01 0f 00 30 82 01 0a 02 82 01 01 00 9d fd 7c 5d 84 a3 a8 f3 73 49 15 6f 83 31 c9 ad 05 7a ff 91 8a bd 28 c1 d6 1f aa 2f 06 75 96 36 94 f6 fe 26 a2 11 f0 7b 35 b3 3c 96 39 88 8a 2d d4 9c dc eb fe 11 b3 7c 5e 32 a8 a8 38 bd 41 82 3a b8 6c bc 99 28 f8 55 d8 1a 7e 11 b5 74 7b 09 dc 40 91 34 b1 3d 03 cf 82 22 6e ed 44 c2 18 61 9d 94 d8 ee 6e e5 3d 17 74 e5 ab e0 0e 09 fd 5c fe e6 85 60 92 10 1b c6 6e 2b b7 02 99 35 31 ef d1 4a 76 e5 8c 43 d2 70 a5 90 8c 9b f6 d9 2d 67 8d 95 2b 20 d9 ec 2d ab 5c 97 53 68 08 ff cb 7e 5f 46 60 34 00 c0 d8 82 bc 75 cd 3d 65 01 9b d1 4e 51 e2 dd 50 fc 69 ee a7 bc 1b a6 94 09 a0 de 86 cc ee 69 80 39 53 98 48 5e 56 31 3a c8 3c c6 a1 e8 5c 65 42 9e 13 4a f2 1f d2 9d 4d ff 2f 44 80 70 e4 63 0f c3 95 90 ec d3 d2 40 18 e5 c7 9d 5d f4 de 01 42 ec 6d 55 ba df e4 cf 61 14 73 3b 02 03 01 00 01 a3 53 30 51 30 1d 06 03 55 1d 0e 04 16 04 14 d5 7e 2b 44 c9 16 1f f7 df bd d7 db 8f be 7e 8a 71 87 ff f6 30 1f 06 03 55 1d 23 04 18 30 16 80 14 d5 7e 2b 44 c9 16 1f f7 df bd d7 db 8f be 7e 8a 71 87 ff f6 30 0f 06 03 55 1d 13 01 01 ff 04 05 30 03 01 01 ff 30 0d 06 09 2a 86 48 86 f7 0d 01 01 0b 05 00 03 82 01 01 00 0b 41 f2 9b 40 69 d6 62 69 5c 31 49 f4 01 73 72 90 7d b9 11 de 72 25 a4 aa 0e 9d 53 3a 52 3f c7 27 56 b7 14 3c 44 76 56 b6 70 85 99 8e 4d 4e f4 f6 df eb fc a7 18 41 85 d4 58 3b bd bf 71 94 cd 92 8f d4 91 59 f3 31 59 1f e6 ab 4d 06 f9 7b f4 8e b5 1c 63 1f 33 3c 14 57 c0 36 ad a0 36 9c d7 84 f8 45 0b dc 51 55 84 ed a2 bc c6 1c d5 78 00 68 35 2e 4c b6 9f c3 92 8b a5 78 ff b3 a1 a7 cb ae 7f 00 51 aa 7e 83 7d 4e 03 8c 2d d7 b0 87 4f f7 f3 62 4a 21 f5 57 f5 ea 32 59 71 1b 32 23 91 1e f1 fa 8b e1 64 d7 c5 eb 51 4e 7a 4e b0 4e 8b 0c 5d 37 44 32 f1 1d e5 fe 4f f4 64 4c c5 af 90 4c 9c 77 48 b2 ab cb 26 50 67 8e 80 34 9c 95 2c 7d 05 1c c1 fb 31 6d ce e5 cd db b5 6f be f1 cb d2 c9 f5 c8 27 39 08 07 1c 5c 53 62 ef 69 3f f7 80 b4 f9 0a de 59 b1 f3 58 62 c3 aa fc a3 5c fb];
	};

	secure_otp@fe3a0000 {
		mask_addr = <0xfe880000>;
		cru_rst_addr = <0xfdd20470>;
		compatible = "rockchip,rk3568-secure-otp";
		secure_conf = <0xfdd18008>;
		reg = <0x00 0xfe3a0000 0x00 0x4000>;
		phandle = <0x145>;
	};

	qos@fe1a8080 {
		compatible = "rockchip,rk3568-qos\0syscon";
		reg = <0x00 0xfe1a8080 0x00 0x20>;
		phandle = <0x30>;
	};

	gpio-regulator {
		regulator-max-microvolt = <0x325aa0>;
		gpios-states = <0x01>;
		regulator-min-microvolt = <0x186a0>;
		regulator-name = "pcie30_3v3";
		compatible = "regulator-gpio";
		states = <0x186a0 0x00 0x325aa0 0x01>;
		phandle = <0xc2>;
		gpios = <0x21 0x1c 0x00>;
	};

	phy@fe830000 {
		rockchip,pipe-grf = <0xad>;
		clock-names = "ref\0apb\0pipe";
		assigned-clocks = <0x1e 0x22>;
		assigned-clock-rates = <0x5f5e100>;
		resets = <0x0e 0x1c7>;
		clocks = <0x1e 0x22 0x0e 0x17d 0x0e 0x7f>;
		#phy-cells = <0x01>;
		compatible = "rockchip,rk3568-naneng-combphy";
		status = "okay";
		rockchip,pipe-phy-grf = <0xae>;
		reg = <0x00 0xfe830000 0x00 0x100>;
		phandle = <0x0f>;
	};

	watchdog@fe600000 {
		clock-names = "tclk\0pclk";
		interrupts = <0x00 0x95 0x04>;
		clocks = <0x0e 0x116 0x0e 0x115>;
		compatible = "rockchip,rk3568-wdt\0snps,dw-wdt";
		reg = <0x00 0xfe600000 0x00 0x100>;
		phandle = <0x117>;
	};

	video-codec@fdea0400 {
		power-domains = <0x10 0x0b>;
		iommus = <0x47>;
		clock-names = "aclk\0hclk";
		interrupts = <0x00 0x8b 0x04>;
		clocks = <0x0e 0xee 0x0e 0xef>;
		compatible = "rockchip,rk3568-vpu";
		reg = <0x00 0xfdea0000 0x00 0x800>;
		phandle = <0xf4>;
	};

	qos@fe128000 {
		compatible = "rockchip,rk3568-qos\0syscon";
		reg = <0x00 0xfe128000 0x00 0x20>;
		phandle = <0x2b>;
	};

	dmc {
		bootph-all;
		compatible = "rockchip,rk3568-dmc";
		status = "okay";
		phandle = <0x149>;
	};

	tsadc@fe710000 {
		pinctrl-names = "init\0default\0sleep";
		pinctrl-2 = <0x9e>;
		pinctrl-0 = <0x9e>;
		clock-names = "tsadc\0apb_pclk";
		rockchip,hw-tshut-polarity = <0x00>;
		assigned-clocks = <0x0e 0x110 0x0e 0x111>;
		assigned-clock-rates = <0x1036640 0xaae60>;
		resets = <0x0e 0x181 0x0e 0x182 0x0e 0x1d7>;
		interrupts = <0x00 0x73 0x04>;
		rockchip,hw-tshut-mode = <0x01>;
		clocks = <0x0e 0x111 0x0e 0x10f>;
		#thermal-sensor-cells = <0x01>;
		compatible = "rockchip,rk3568-tsadc";
		pinctrl-1 = <0x9f>;
		status = "okay";
		rockchip,grf = <0x1c>;
		reg = <0x00 0xfe710000 0x00 0x100>;
		phandle = <0x9a>;
		rockchip,hw-tshut-temp = <0x17318>;
	};

	phy@fe870000 {
		clock-names = "pclk";
		resets = <0x0e 0x1ba>;
		clocks = <0x0e 0x179>;
		#phy-cells = <0x00>;
		compatible = "rockchip,rk3568-csi-dphy";
		status = "disabled";
		rockchip,grf = <0x1c>;
		reg = <0x00 0xfe870000 0x00 0x10000>;
		phandle = <0x138>;
		reset-names = "apb";
	};

	mmc@fe000000 {
		fifo-depth = <0x100>;
		clock-names = "biu\0ciu\0ciu-drive\0ciu-sample";
		resets = <0x0e 0xeb>;
		interrupts = <0x00 0x64 0x04>;
		clocks = <0x0e 0xc1 0x0e 0xc2 0x0e 0x18e 0x0e 0x18f>;
		compatible = "rockchip,rk3568-dw-mshc\0rockchip,rk3288-dw-mshc";
		status = "disabled";
		reg = <0x00 0xfe000000 0x00 0x4000>;
		phandle = <0xf6>;
		max-frequency = <0x8f0d180>;
		reset-names = "reset";
	};

	qos@fe138080 {
		compatible = "rockchip,rk3568-qos\0syscon";
		reg = <0x00 0xfe138080 0x00 0x20>;
		phandle = <0x3a>;
	};

	serial@fe670000 {
		reg-io-width = <0x04>;
		pinctrl-names = "default";
		pinctrl-0 = <0x93>;
		clock-names = "baudclk\0apb_pclk";
		interrupts = <0x00 0x77 0x04>;
		clocks = <0x0e 0x127 0x0e 0x124>;
		compatible = "rockchip,rk3568-uart\0snps,dw-apb-uart";
		status = "disabled";
		reg = <0x00 0xfe670000 0x00 0x100>;
		phandle = <0x11e>;
		dmas = <0x25 0x06 0x25 0x07>;
		reg-shift = <0x02>;
	};

	syscon@fdca0000 {
		compatible = "rockchip,rk3568-usb2phy-grf\0syscon";
		reg = <0x00 0xfdca0000 0x00 0x8000>;
		phandle = <0xb0>;
	};

	hdmi-sound {
		simple-audio-card,name = "HDMI";
		simple-audio-card,format = "i2s";
		compatible = "simple-audio-card";
		status = "okay";
		phandle = <0xdc>;
		simple-audio-card,mclk-fs = <0x100>;

		simple-audio-card,cpu {
			sound-dai = <0x08>;
		};

		simple-audio-card,codec {
			sound-dai = <0x07>;
		};
	};

	usb2phy@fe8b0000 {
		rockchip,usbgrf = <0xb3>;
		clock-output-names = "clk_usbphy1_480m";
		clock-names = "phyclk";
		interrupts = <0x00 0x88 0x04>;
		clocks = <0x1e 0x15>;
		#clock-cells = <0x00>;
		compatible = "rockchip,rk3568-usb2phy";
		status = "okay";
		reg = <0x00 0xfe8b0000 0x00 0x10000>;
		phandle = <0x139>;

		host-port {
			phy-supply = <0xb1>;
			#phy-cells = <0x00>;
			status = "okay";
			phandle = <0x16>;
		};

		otg-port {
			phy-supply = <0xb1>;
			#phy-cells = <0x00>;
			status = "okay";
			phandle = <0x15>;
		};
	};

	xin32k {
		pinctrl-names = "default";
		clock-output-names = "xin32k";
		pinctrl-0 = <0x0d>;
		#clock-cells = <0x00>;
		clock-frequency = <0x8000>;
		compatible = "fixed-clock";
		phandle = <0xdd>;
	};

	pcie@fe280000 {
		power-domains = <0x10 0x0f>;
		vpcie3v3-supply = <0xc2>;
		pinctrl-names = "default";
		#address-cells = <0x03>;
		phy-names = "pcie-phy";
		bus-range = <0x00 0x1f>;
		clock-names = "aclk_mst\0aclk_slv\0aclk_dbi\0pclk";
		reg-names = "pcie-dbi\0pcie-apb";
		num-ob-windows = <0x02>;
		resets = <0x0e 0xc1>;
		interrupts = <0x00 0xa5 0x04 0x00 0xa4 0x04 0x00 0xa3 0x04 0x00 0xa2 0x04 0x00 0xa1 0x04>;
		clocks = <0x0e 0x8f 0x0e 0x90 0x0e 0x91 0x0e 0x92>;
		#size-cells = <0x02>;
		max-link-speed = <0x03>;
		device_type = "pci";
		reset-gpios = <0x4c 0x1e 0x00>;
		num-lanes = <0x01>;
		compatible = "rockchip,rk3568-pcie\0snps,dw-pcie";
		ranges = <0x800 0x00 0x80000000 0x03 0x80000000 0x00 0x800000 0x81000000 0x00 0x80800000 0x03 0x80800000 0x00 0x100000 0x83000000 0x00 0x80900000 0x03 0x80900000 0x00 0x3f700000>;
		msi-map = <0x00 0x01 0x2000 0x1000>;
		status = "okay";
		interrupt-names = "sys\0pmc\0msg\0legacy\0err";
		phys = <0xc1>;
		reg = <0x03 0xc0800000 0x00 0x400000 0x00 0xfe280000 0x00 0x10000>;
		linux,pci-domain = <0x02>;
		phandle = <0x13e>;
		reset-names = "pipe";
		num-ib-windows = <0x06>;
	};

	sata@fc400000 {
		power-domains = <0x10 0x0f>;
		phy-names = "sata-phy";
		clock-names = "sata\0pmalive\0rxoob";
		interrupts = <0x00 0x5f 0x04>;
		clocks = <0x0e 0x9b 0x0e 0x9c 0x0e 0x9d>;
		compatible = "rockchip,rk3568-dwc-ahci\0snps,dwc-ahci";
		status = "disabled";
		phys = <0x0f 0x01>;
		reg = <0x00 0xfc400000 0x00 0x1000>;
		phandle = <0xde>;
		ports-implemented = <0x01>;
	};

	ethernet@fe010000 {
		pinctrl-names = "default";
		phy-mode = "rgmii";
		snps,mixed-burst;
		snps,mtl-rx-config = <0x4a>;
		snps,reset-active-low;
		pinctrl-0 = <0x4d 0x4e 0x4f 0x50 0x51>;
		clock-names = "stmmaceth\0mac_clk_rx\0mac_clk_tx\0clk_mac_refout\0aclk_mac\0pclk_mac\0clk_mac_speed\0ptp_ref";
		assigned-clocks = <0x0e 0x189 0x0e 0x186>;
		assigned-clock-parents = <0x0e 0x187>;
		snps,mtl-tx-config = <0x4b>;
		local-mac-address = [06 71 08 aa 96 ca];
		assigned-clock-rates = <0x00 0x7735940>;
		resets = <0x0e 0xec>;
		interrupts = <0x00 0x20 0x04 0x00 0x1d 0x04>;
		clocks = <0x0e 0x186 0x0e 0x189 0x0e 0x189 0x0e 0xc7 0x0e 0xc3 0x0e 0xc4 0x0e 0x189 0x0e 0xc8>;
		clock_in_out = "output";
		snps,tso;
		compatible = "rockchip,rk3568-gmac\0snps,dwmac-4.20a";
		status = "disabled";
		rockchip,grf = <0x1c>;
		interrupt-names = "macirq\0eth_wake_irq";
		snps,reset-gpio = <0x4c 0x19 0x01>;
		reg = <0x00 0xfe010000 0x00 0x10000>;
		rx_delay = <0x26>;
		phandle = <0xf7>;
		phy-handle = <0x52>;
		reset-names = "stmmaceth";
		tx_delay = <0x4f>;
		snps,axi-config = <0x49>;
		snps,reset-delays-us = <0x00 0x4e20 0x186a0>;

		mdio {
			#address-cells = <0x01>;
			#size-cells = <0x00>;
			compatible = "snps,dwmac-mdio";
			phandle = <0xf8>;

			ethernet-phy@0 {
				reset-deassert-us = <0x186a0>;
				reset-assert-us = <0x4e20>;
				reset-gpios = <0x4c 0x19 0x01>;
				compatible = "ethernet-phy-ieee802.3-c22";
				reg = <0x00>;
				phandle = <0x52>;
			};
		};

		tx-queues-config {
			phandle = <0x4b>;
			snps,tx-queues-to-use = <0x01>;

			queue0 {
			};
		};

		stmmac-axi-config {
			snps,wr_osr_lmt = <0x04>;
			phandle = <0x49>;
			snps,blen = <0x00 0x00 0x00 0x00 0x10 0x08 0x04>;
			snps,rd_osr_lmt = <0x08>;
		};

		rx-queues-config {
			snps,rx-queues-to-use = <0x01>;
			phandle = <0x4a>;

			queue0 {
			};
		};
	};

	display-subsystem {
		ports = <0x05>;
		compatible = "rockchip,display-subsystem";
		phandle = <0xda>;
	};

	spi@fe630000 {
		pinctrl-names = "default";
		#address-cells = <0x01>;
		pinctrl-0 = <0x8b 0x8c 0x8d>;
		clock-names = "spiclk\0apb_pclk";
		interrupts = <0x00 0x69 0x04>;
		clocks = <0x0e 0x156 0x0e 0x155>;
		#size-cells = <0x00>;
		dma-names = "tx\0rx";
		compatible = "rockchip,rk3568-spi\0rockchip,rk3066-spi";
		status = "disabled";
		reg = <0x00 0xfe630000 0x00 0x1000>;
		phandle = <0x11a>;
		dmas = <0x25 0x18 0x25 0x19>;
	};

	adc-keys {
		u-boot,dm-spl;
		io-channels = <0xd9 0x00>;
		keyup-threshold-microvolt = <0x1b7740>;
		compatible = "adc-keys";
		status = "okay";
		io-channel-names = "buttons";

		volumeup-key {
			u-boot,dm-spl;
			press-threshold-microvolt = <0x09>;
			label = "volume up";
			linux,code = <0x73>;
		};
	};

	i2c@fe5d0000 {
		pinctrl-names = "default";
		#address-cells = <0x01>;
		pinctrl-0 = <0x83>;
		clock-names = "i2c\0pclk";
		interrupts = <0x00 0x32 0x04>;
		clocks = <0x0e 0x14e 0x0e 0x14d>;
		#size-cells = <0x00>;
		compatible = "rockchip,rk3568-i2c\0rockchip,rk3399-i2c";
		status = "disabled";
		reg = <0x00 0xfe5d0000 0x00 0x1000>;
		phandle = <0x115>;
	};

	clock-controller@fdd00000 {
		#reset-cells = <0x01>;
		bootph-all;
		#clock-cells = <0x01>;
		compatible = "rockchip,rk3568-pmucru";
		status = "okay";
		rockchip,grf = <0x1c>;
		reg = <0x00 0xfdd00000 0x00 0x1000>;
		phandle = <0x1e>;
	};

	thermal-zones {
		phandle = <0x125>;

		cpu-thermal {
			polling-delay = <0x3e8>;
			polling-delay-passive = <0x64>;
			thermal-sensors = <0x9a 0x00>;
			phandle = <0x126>;

			trips {

				cpu_crit {
					temperature = <0x17318>;
					hysteresis = <0x7d0>;
					type = "critical";
					phandle = <0x128>;
				};

				cpu_alert0 {
					temperature = <0x11170>;
					hysteresis = <0x7d0>;
					type = "passive";
					phandle = <0x9b>;
				};

				cpu_alert1 {
					temperature = <0x124f8>;
					hysteresis = <0x7d0>;
					type = "passive";
					phandle = <0x127>;
				};
			};

			cooling-maps {

				map0 {
					trip = <0x9b>;
					cooling-device = <0x09 0xffffffff 0xffffffff 0x0a 0xffffffff 0xffffffff 0x0b 0xffffffff 0xffffffff 0x0c 0xffffffff 0xffffffff>;
				};
			};
		};

		gpu-thermal {
			polling-delay = <0x3e8>;
			polling-delay-passive = <0x14>;
			thermal-sensors = <0x9a 0x01>;
			phandle = <0x129>;

			trips {

				gpu-threshold {
					temperature = <0x11170>;
					hysteresis = <0x7d0>;
					type = "passive";
					phandle = <0x12a>;
				};

				gpu-crit {
					temperature = <0x17318>;
					hysteresis = <0x7d0>;
					type = "critical";
					phandle = <0x12b>;
				};

				gpu-target {
					temperature = <0x124f8>;
					hysteresis = <0x7d0>;
					type = "passive";
					phandle = <0x9c>;
				};
			};

			cooling-maps {

				map0 {
					trip = <0x9c>;
					cooling-device = <0x9d 0xffffffff 0xffffffff>;
				};
			};
		};
	};

	syscon@fdc70000 {
		compatible = "rockchip,rk3568-pipe-phy-grf\0syscon";
		reg = <0x00 0xfdc70000 0x00 0x1000>;
		phandle = <0xcc>;
	};

	qos@fe158200 {
		compatible = "rockchip,rk3568-qos\0syscon";
		reg = <0x00 0xfe158200 0x00 0x20>;
		phandle = <0x35>;
	};

	vcc5v0-sys {
		regulator-max-microvolt = <0x4c4b40>;
		regulator-boot-on;
		regulator-always-on;
		regulator-min-microvolt = <0x4c4b40>;
		regulator-name = "vcc5v0_sys";
		compatible = "regulator-fixed";
		phandle = <0x20>;
		vin-supply = <0xd1>;
	};

	i2s@fe400000 {
		clock-names = "mclk_tx\0mclk_rx\0hclk";
		assigned-clocks = <0x0e 0x3d 0x0e 0x41>;
		assigned-clock-rates = <0x46cf7100 0x46cf7100>;
		resets = <0x0e 0x50 0x0e 0x51>;
		interrupts = <0x00 0x34 0x04>;
		clocks = <0x0e 0x3f 0x0e 0x43 0x0e 0x39>;
		dma-names = "tx";
		#sound-dai-cells = <0x00>;
		compatible = "rockchip,rk3568-i2s-tdm";
		status = "okay";
		rockchip,grf = <0x1c>;
		reg = <0x00 0xfe400000 0x00 0x1000>;
		phandle = <0x08>;
		dmas = <0x65 0x00>;
		reset-names = "tx-m\0rx-m";
	};

	qos@fe1a8000 {
		compatible = "rockchip,rk3568-qos\0syscon";
		reg = <0x00 0xfe1a8000 0x00 0x20>;
		phandle = <0x2f>;
	};

	vcc5v0-usb-otg {
		regulator-max-microvolt = <0x4c4b40>;
		pinctrl-names = "default";
		gpio = <0x21 0x05 0x00>;
		pinctrl-0 = <0xd4>;
		enable-active-high;
		regulator-min-microvolt = <0x4c4b40>;
		regulator-name = "vcc5v0_usb_otg";
		compatible = "regulator-fixed";
		phandle = <0xb2>;
		vin-supply = <0xd3>;
	};

	serial@fe6b0000 {
		reg-io-width = <0x04>;
		pinctrl-names = "default";
		pinctrl-0 = <0x97>;
		clock-names = "baudclk\0apb_pclk";
		interrupts = <0x00 0x7b 0x04>;
		clocks = <0x0e 0x137 0x0e 0x134>;
		compatible = "rockchip,rk3568-uart\0snps,dw-apb-uart";
		status = "disabled";
		reg = <0x00 0xfe6b0000 0x00 0x100>;
		phandle = <0x122>;
		dmas = <0x25 0x0e 0x25 0x0f>;
		reg-shift = <0x02>;
	};

	qos@fe148100 {
		compatible = "rockchip,rk3568-qos\0syscon";
		reg = <0x00 0xfe148100 0x00 0x20>;
		phandle = <0x2e>;
	};

	leds {
		compatible = "gpio-leds";

		led-0 {
			linux,default-trigger = "heartbeat";
			pinctrl-names = "default";
			function = "heartbeat";
			color = <0x03>;
			pinctrl-0 = <0xce>;
			phandle = <0x142>;
			gpios = <0x21 0x10 0x00>;
		};
	};

	qos@fe190100 {
		compatible = "rockchip,rk3568-qos\0syscon";
		reg = <0x00 0xfe190100 0x00 0x20>;
		phandle = <0x3f>;
	};

	psci {
		method = "smc";
		compatible = "arm,psci-1.0";
	};

	phy@fe840000 {
		rockchip,pipe-grf = <0xad>;
		clock-names = "ref\0apb\0pipe";
		assigned-clocks = <0x1e 0x25>;
		assigned-clock-rates = <0x5f5e100>;
		resets = <0x0e 0x1c9>;
		clocks = <0x1e 0x25 0x0e 0x17e 0x0e 0x7f>;
		#phy-cells = <0x01>;
		compatible = "rockchip,rk3568-naneng-combphy";
		status = "disabled";
		rockchip,pipe-phy-grf = <0xaf>;
		reg = <0x00 0xfe840000 0x00 0x100>;
		phandle = <0x11>;
	};

	usb@fd800000 {
		phy-names = "usb";
		interrupts = <0x00 0x82 0x04>;
		clocks = <0x0e 0xbd 0x0e 0xbe 0x0e 0xbc>;
		compatible = "generic-ehci";
		status = "okay";
		phys = <0x15>;
		reg = <0x00 0xfd800000 0x00 0x40000>;
		phandle = <0xe2>;
	};

	xin24m {
		clock-output-names = "xin24m";
		bootph-all;
		#clock-cells = <0x00>;
		clock-frequency = <0x16e3600>;
		compatible = "fixed-clock";
		status = "okay";
		phandle = <0x1d>;
	};

	ethernet@fe2a0000 {
		pinctrl-names = "default";
		phy-mode = "rgmii";
		snps,mixed-burst;
		snps,mtl-rx-config = <0xc4>;
		snps,reset-active-low;
		pinctrl-0 = <0xc6 0xc7 0xc8 0xc9 0xca>;
		clock-names = "stmmaceth\0mac_clk_rx\0mac_clk_tx\0clk_mac_refout\0aclk_mac\0pclk_mac\0clk_mac_speed\0ptp_ref";
		assigned-clocks = <0x0e 0x185 0x0e 0x182>;
		assigned-clock-parents = <0x0e 0x183>;
		snps,mtl-tx-config = <0xc5>;
		local-mac-address = [06 71 08 aa 96 cb];
		assigned-clock-rates = <0x00 0x7735940>;
		resets = <0x0e 0xd7>;
		interrupts = <0x00 0x1b 0x04 0x00 0x18 0x04>;
		clocks = <0x0e 0x182 0x0e 0x185 0x0e 0x185 0x0e 0xb8 0x0e 0xb4 0x0e 0xb5 0x0e 0x185 0x0e 0xb9>;
		clock_in_out = "output";
		snps,tso;
		compatible = "rockchip,rk3568-gmac\0snps,dwmac-4.20a";
		status = "disabled";
		rockchip,grf = <0x1c>;
		interrupt-names = "macirq\0eth_wake_irq";
		snps,reset-gpio = <0x4c 0x1b 0x01>;
		reg = <0x00 0xfe2a0000 0x00 0x10000>;
		rx_delay = <0x2f>;
		phandle = <0x13f>;
		phy-handle = <0xcb>;
		reset-names = "stmmaceth";
		tx_delay = <0x3c>;
		snps,axi-config = <0xc3>;
		snps,reset-delays-us = <0x00 0x4e20 0x186a0>;

		mdio {
			#address-cells = <0x01>;
			#size-cells = <0x00>;
			compatible = "snps,dwmac-mdio";
			phandle = <0x140>;

			ethernet-phy@0 {
				reset-deassert-us = <0x186a0>;
				reset-assert-us = <0x4e20>;
				reset-gpios = <0x4c 0x1b 0x01>;
				compatible = "ethernet-phy-ieee802.3-c22";
				reg = <0x00>;
				phandle = <0xcb>;
			};
		};

		tx-queues-config {
			phandle = <0xc5>;
			snps,tx-queues-to-use = <0x01>;

			queue0 {
			};
		};

		stmmac-axi-config {
			snps,wr_osr_lmt = <0x04>;
			phandle = <0xc3>;
			snps,blen = <0x00 0x00 0x00 0x00 0x10 0x08 0x04>;
			snps,rd_osr_lmt = <0x08>;
		};

		rx-queues-config {
			snps,rx-queues-to-use = <0x01>;
			phandle = <0xc4>;

			queue0 {
			};
		};
	};

	video-codec@fdee0000 {
		power-domains = <0x10 0x0a>;
		iommus = <0x48>;
		clock-names = "aclk\0hclk";
		interrupts = <0x00 0x40 0x04>;
		clocks = <0x0e 0xfd 0x0e 0xfe>;
		compatible = "rockchip,rk3568-vepu";
		reg = <0x00 0xfdee0000 0x00 0x800>;
		phandle = <0xf5>;
	};

	qos@fe158180 {
		compatible = "rockchip,rk3568-qos\0syscon";
		reg = <0x00 0xfe158180 0x00 0x20>;
		phandle = <0x34>;
	};

	fit-images {

		atf-2 {
			load = <0x00 0x66000>;
			os = "arm-trusted-firmware";
			type = "firmware";
			size = <0x1df4>;
			arch = "arm64";
		};

		atf-5 {
			load = <0x00 0xfdcd0000>;
			os = "arm-trusted-firmware";
			type = "firmware";
			size = <0x2000>;
			arch = "arm64";
		};

		u-boot {
			load = <0x00 0xa00000>;
			os = "U-Boot";
			type = "standalone";
			size = <0x12ae60>;
			arch = "arm64";
			entry = <0x00 0xa00000>;
		};

		atf-3 {
			load = <0x00 0x68000>;
			os = "arm-trusted-firmware";
			type = "firmware";
			size = <0x4c4b>;
			arch = "arm64";
		};

		atf-4 {
			load = <0x00 0xfdcc9000>;
			os = "arm-trusted-firmware";
			type = "firmware";
			size = <0x2000>;
			arch = "arm64";
		};
	};

	qos@fe180000 {
		compatible = "rockchip,rk3568-qos\0syscon";
		reg = <0x00 0xfe180000 0x00 0x20>;
		phandle = <0x105>;
	};

	usb@fd840000 {
		phy-names = "usb";
		interrupts = <0x00 0x83 0x04>;
		clocks = <0x0e 0xbd 0x0e 0xbe 0x0e 0xbc>;
		compatible = "generic-ohci";
		status = "okay";
		phys = <0x15>;
		reg = <0x00 0xfd840000 0x00 0x40000>;
		phandle = <0xe3>;
	};

	hdmi@fe0a0000 {
		power-domains = <0x10 0x09>;
		reg-io-width = <0x04>;
		pinctrl-names = "default";
		avdd-1v8-supply = <0x5b>;
		pinctrl-0 = <0x57 0x58 0x59>;
		clock-names = "iahb\0isfr\0cec\0ref";
		interrupts = <0x00 0x2d 0x04>;
		clocks = <0x0e 0xe6 0x0e 0xe7 0x0e 0x193 0x1e 0x28 0x0e 0xda>;
		#sound-dai-cells = <0x00>;
		compatible = "rockchip,rk3568-dw-hdmi";
		status = "okay";
		rockchip,grf = <0x1c>;
		reg = <0x00 0xfe0a0000 0x00 0x20000>;
		phandle = <0x07>;
		avdd-0v9-supply = <0x5a>;

		ports {
			#address-cells = <0x01>;
			#size-cells = <0x00>;

			port@0 {
				reg = <0x00>;
				phandle = <0x103>;

				endpoint {
					remote-endpoint = <0x5c>;
					phandle = <0x54>;
				};
			};

			port@1 {
				reg = <0x01>;
				phandle = <0x104>;

				endpoint {
					remote-endpoint = <0x5d>;
					phandle = <0xcd>;
				};
			};
		};
	};

	power-management@fdd90000 {
		compatible = "rockchip,rk3568-pmu\0syscon\0simple-mfd";
		reg = <0x00 0xfdd90000 0x00 0x1000>;
		phandle = <0xf3>;

		power-controller {
			#address-cells = <0x01>;
			#size-cells = <0x00>;
			#power-domain-cells = <0x01>;
			compatible = "rockchip,rk3568-power-controller";
			phandle = <0x10>;

			power-domain@9 {
				clocks = <0x0e 0xda 0x0e 0xdb 0x0e 0xdc>;
				#power-domain-cells = <0x00>;
				reg = <0x09>;
				pm_qos = <0x2f 0x30 0x31>;
			};

			power-domain@7 {
				clocks = <0x0e 0x19 0x0e 0x1a>;
				#power-domain-cells = <0x00>;
				reg = <0x07>;
				pm_qos = <0x2b>;
			};

			power-domain@15 {
				clocks = <0x0e 0x7f>;
				#power-domain-cells = <0x00>;
				reg = <0x0f>;
				pm_qos = <0x3d 0x3e 0x3f 0x40 0x41 0x42 0x43 0x44>;
			};

			power-domain@13 {
				clocks = <0x0e 0x107>;
				#power-domain-cells = <0x00>;
				reg = <0x0d>;
				pm_qos = <0x39>;
			};

			power-domain@11 {
				clocks = <0x0e 0xed>;
				#power-domain-cells = <0x00>;
				reg = <0x0b>;
				pm_qos = <0x38>;
			};

			power-domain@8 {
				clocks = <0x0e 0xcc 0x0e 0xcd>;
				#power-domain-cells = <0x00>;
				reg = <0x08>;
				pm_qos = <0x2c 0x2d 0x2e>;
			};

			power-domain@14 {
				clocks = <0x0e 0x102>;
				#power-domain-cells = <0x00>;
				reg = <0x0e>;
				pm_qos = <0x3a 0x3b 0x3c>;
			};

			power-domain@10 {
				clocks = <0x0e 0xf1 0x0e 0xf2>;
				#power-domain-cells = <0x00>;
				reg = <0x0a>;
				pm_qos = <0x32 0x33 0x34 0x35 0x36 0x37>;
			};
		};
	};

	qos@fe148080 {
		compatible = "rockchip,rk3568-qos\0syscon";
		reg = <0x00 0xfe148080 0x00 0x20>;
		phandle = <0x2d>;
	};

	serial@fe680000 {
		reg-io-width = <0x04>;
		pinctrl-names = "default";
		pinctrl-0 = <0x94>;
		clock-names = "baudclk\0apb_pclk";
		interrupts = <0x00 0x78 0x04>;
		clocks = <0x0e 0x12b 0x0e 0x128>;
		compatible = "rockchip,rk3568-uart\0snps,dw-apb-uart";
		status = "disabled";
		reg = <0x00 0xfe680000 0x00 0x100>;
		phandle = <0x11f>;
		dmas = <0x25 0x08 0x25 0x09>;
		reg-shift = <0x02>;
	};

	usb@fd880000 {
		phy-names = "usb";
		interrupts = <0x00 0x85 0x04>;
		clocks = <0x0e 0xbf 0x0e 0xc0 0x0e 0xbc>;
		compatible = "generic-ehci";
		status = "okay";
		phys = <0x16>;
		reg = <0x00 0xfd880000 0x00 0x40000>;
		phandle = <0xe4>;
	};

	qos@fe190080 {
		compatible = "rockchip,rk3568-qos\0syscon";
		reg = <0x00 0xfe190080 0x00 0x20>;
		phandle = <0x3e>;
	};

	qos@fe190400 {
		compatible = "rockchip,rk3568-qos\0syscon";
		reg = <0x00 0xfe190400 0x00 0x20>;
		phandle = <0x44>;
	};

	dma-controller@fe550000 {
		clock-names = "apb_pclk";
		interrupts = <0x00 0x10 0x04 0x00 0x0f 0x04>;
		clocks = <0x0e 0x10d>;
		arm,pl330-periph-burst;
		compatible = "arm,pl330\0arm,primecell";
		reg = <0x00 0xfe550000 0x00 0x4000>;
		phandle = <0x65>;
		#dma-cells = <0x01>;
	};

	saradc@fe720000 {
		vref-supply = <0xa0>;
		clock-names = "saradc\0apb_pclk";
		resets = <0x0e 0x180>;
		interrupts = <0x00 0x5d 0x04>;
		clocks = <0x0e 0x113 0x0e 0x112>;
		#io-channel-cells = <0x01>;
		compatible = "rockchip,rk3568-saradc\0rockchip,rk3399-saradc";
		status = "okay";
		reg = <0x00 0xfe720000 0x00 0x100>;
		phandle = <0xd9>;
		reset-names = "saradc-apb";
	};

	vcc5v0-usb-host {
		regulator-max-microvolt = <0x4c4b40>;
		pinctrl-names = "default";
		gpio = <0x21 0x06 0x00>;
		pinctrl-0 = <0xd2>;
		enable-active-high;
		regulator-min-microvolt = <0x4c4b40>;
		regulator-name = "vcc5v0_usb_host";
		compatible = "regulator-fixed";
		phandle = <0xb1>;
		vin-supply = <0xd3>;
	};

	vcc3v3-lcd1-n {
		regulator-max-microvolt = <0x325aa0>;
		pinctrl-names = "default";
		gpio = <0x21 0x15 0x00>;
		pinctrl-0 = <0xd6>;
		enable-active-high;
		regulator-min-microvolt = <0x325aa0>;
		regulator-name = "vcc3v3_lcd1_n";
		compatible = "regulator-fixed";
		phandle = <0x143>;
		vin-supply = <0x24>;

		regulator-state-mem {
			regulator-off-in-suspend;
		};
	};

	syscon@fdca8000 {
		compatible = "rockchip,rk3568-usb2phy-grf\0syscon";
		reg = <0x00 0xfdca8000 0x00 0x8000>;
		phandle = <0xb3>;
	};

	i2c@fe5a0000 {
		pinctrl-names = "default";
		#address-cells = <0x01>;
		pinctrl-0 = <0x7d>;
		clock-names = "i2c\0pclk";
		interrupts = <0x00 0x2f 0x04>;
		clocks = <0x0e 0x148 0x0e 0x147>;
		#size-cells = <0x00>;
		compatible = "rockchip,rk3568-i2c\0rockchip,rk3399-i2c";
		status = "okay";
		reg = <0x00 0xfe5a0000 0x00 0x1000>;
		phandle = <0x111>;

		goodix@14 {
			pinctrl-names = "default";
			pinctrl-0 = <0x7f 0x80>;
			irq-gpios = <0x21 0x0d 0x00>;
			interrupts = <0x0d 0x02>;
			interrupt-parent = <0x21>;
			reset-gpios = <0x21 0x0e 0x00>;
			VDDIO-supply = <0x7e>;
			compatible = "goodix,gt1151";
			reg = <0x14>;
			phandle = <0x112>;
			AVDD28-supply = <0x7e>;
		};
	};

	sram@10f000 {
		#address-cells = <0x01>;
		#size-cells = <0x01>;
		compatible = "mmio-sram";
		ranges = <0x00 0x00 0x10f000 0x100>;
		reg = <0x00 0x10f000 0x00 0x100>;

		sram@0 {
			compatible = "arm,scmi-shmem";
			reg = <0x00 0x100>;
			phandle = <0x06>;
		};
	};

	spi@fe640000 {
		pinctrl-names = "default";
		#address-cells = <0x01>;
		pinctrl-0 = <0x8e 0x8f 0x90>;
		clock-names = "spiclk\0apb_pclk";
		interrupts = <0x00 0x6a 0x04>;
		clocks = <0x0e 0x158 0x0e 0x157>;
		#size-cells = <0x00>;
		dma-names = "tx\0rx";
		compatible = "rockchip,rk3568-spi\0rockchip,rk3066-spi";
		status = "disabled";
		reg = <0x00 0xfe640000 0x00 0x1000>;
		phandle = <0x11b>;
		dmas = <0x25 0x1a 0x25 0x1b>;
	};

	i2c@fe5e0000 {
		pinctrl-names = "default";
		#address-cells = <0x01>;
		pinctrl-0 = <0x84>;
		clock-names = "i2c\0pclk";
		interrupts = <0x00 0x33 0x04>;
		clocks = <0x0e 0x150 0x0e 0x14f>;
		#size-cells = <0x00>;
		compatible = "rockchip,rk3568-i2c\0rockchip,rk3399-i2c";
		status = "disabled";
		reg = <0x00 0xfe5e0000 0x00 0x1000>;
		phandle = <0x116>;
	};

	dsi@fe060000 {
		power-domains = <0x10 0x09>;
		phy-names = "dphy";
		clock-names = "pclk";
		resets = <0x0e 0x110>;
		interrupts = <0x00 0x44 0x04>;
		clocks = <0x0e 0xe8>;
		compatible = "rockchip,rk3568-mipi-dsi\0snps,dw-mipi-dsi";
		status = "disabled";
		rockchip,grf = <0x1c>;
		phys = <0x55>;
		reg = <0x00 0xfe060000 0x00 0x10000>;
		phandle = <0xfd>;
		reset-names = "apb";

		ports {
			#address-cells = <0x01>;
			#size-cells = <0x00>;

			port@0 {
				reg = <0x00>;
				phandle = <0xfe>;
			};

			port@1 {
				reg = <0x01>;
				phandle = <0xff>;
			};
		};
	};

	qos@fe190380 {
		compatible = "rockchip,rk3568-qos\0syscon";
		reg = <0x00 0xfe190380 0x00 0x20>;
		phandle = <0x43>;
	};

	vcc3v3-sys {
		regulator-max-microvolt = <0x325aa0>;
		regulator-boot-on;
		regulator-always-on;
		regulator-min-microvolt = <0x325aa0>;
		regulator-name = "vcc3v3_sys";
		compatible = "regulator-fixed";
		phandle = <0x24>;
		vin-supply = <0xd1>;
	};

	syscon@fdc80000 {
		compatible = "rockchip,rk3568-pipe-phy-grf\0syscon";
		reg = <0x00 0xfdc80000 0x00 0x1000>;
		phandle = <0xae>;
	};

	timer {
		arm,no-tick-in-suspend;
		interrupts = <0x01 0x0d 0x04 0x01 0x0e 0x04 0x01 0x0b 0x04 0x01 0x0a 0x04>;
		compatible = "arm,armv8-timer";
	};

	opp-table-0 {
		opp-shared;
		compatible = "operating-points-v2";
		phandle = <0x03>;

		opp-1992000000 {
			opp-microvolt = <0x118c30 0x118c30 0x118c30>;
			opp-hz = <0x00 0x76bb8200>;
		};

		opp-1800000000 {
			opp-microvolt = <0x100590 0x100590 0x118c30>;
			opp-hz = <0x00 0x6b49d200>;
		};

		opp-1608000000 {
			opp-microvolt = <0xee098 0xee098 0x118c30>;
			opp-hz = <0x00 0x5fd82200>;
		};

		opp-1104000000 {
			opp-microvolt = <0xdbba0 0xdbba0 0x118c30>;
			opp-hz = <0x00 0x41cdb400>;
		};

		opp-816000000 {
			opp-microvolt = <0xdbba0 0xdbba0 0x118c30>;
			opp-hz = <0x00 0x30a32c00>;
			opp-suspend;
		};

		opp-600000000 {
			opp-microvolt = <0xdbba0 0xdbba0 0x118c30>;
			opp-hz = <0x00 0x23c34600>;
		};

		opp-1416000000 {
			opp-microvolt = <0xdbba0 0xdbba0 0x118c30>;
			opp-hz = <0x00 0x54667200>;
		};

		opp-408000000 {
			opp-microvolt = <0xdbba0 0xdbba0 0x118c30>;
			opp-hz = <0x00 0x18519600>;
			clock-latency-ns = <0x9c40>;
		};
	};

	phy@fe8c0000 {
		clock-names = "refclk_m\0refclk_n\0pclk";
		resets = <0x0e 0x1be>;
		clocks = <0x1e 0x26 0x1e 0x27 0x0e 0x177>;
		#phy-cells = <0x00>;
		compatible = "rockchip,rk3568-pcie3-phy";
		status = "okay";
		reg = <0x00 0xfe8c0000 0x00 0x20000>;
		phandle = <0xc1>;
		reset-names = "phy";
		rockchip,phy-grf = <0xbf>;
	};

	i2s@fe410000 {
		pinctrl-names = "default";
		pinctrl-0 = <0x66 0x67 0x68 0x69 0x6a 0x6b 0x6c 0x6d 0x6e 0x6f 0x70 0x71>;
		clock-names = "mclk_tx\0mclk_rx\0hclk";
		assigned-clocks = <0x0e 0x45 0x0e 0x49>;
		assigned-clock-rates = <0x46cf7100 0x46cf7100>;
		resets = <0x0e 0x52 0x0e 0x53>;
		interrupts = <0x00 0x35 0x04>;
		clocks = <0x0e 0x47 0x0e 0x4b 0x0e 0x3a>;
		dma-names = "rx\0tx";
		#sound-dai-cells = <0x00>;
		compatible = "rockchip,rk3568-i2s-tdm";
		status = "okay";
		rockchip,grf = <0x1c>;
		reg = <0x00 0xfe410000 0x00 0x1000>;
		rockchip,trcm-sync-tx-only;
		phandle = <0xcf>;
		dmas = <0x65 0x03 0x65 0x02>;
		reset-names = "tx-m\0rx-m";
	};

	sdio-pwrseq {
		pinctrl-names = "default";
		pinctrl-0 = <0xd7>;
		clock-names = "ext_clock";
		clocks = <0xd0 0x01>;
		reset-gpios = <0xd8 0x1d 0x01>;
		compatible = "mmc-pwrseq-simple";
		post-power-on-delay-ms = <0xc8>;
		status = "okay";
		phandle = <0x146>;
	};

	hdmi-con {
		type = "a";
		compatible = "hdmi-connector";

		port {

			endpoint {
				remote-endpoint = <0xcd>;
				phandle = <0x5d>;
			};
		};
	};

	pwm@fe6e0030 {
		pinctrl-names = "default";
		pinctrl-0 = <0xa4>;
		clock-names = "pwm\0pclk";
		clocks = <0x0e 0x15a 0x0e 0x159>;
		#pwm-cells = <0x03>;
		compatible = "rockchip,rk3568-pwm\0rockchip,rk3328-pwm";
		status = "disabled";
		reg = <0x00 0xfe6e0030 0x00 0x10>;
		phandle = <0x12f>;
	};

	serial@fe6c0000 {
		reg-io-width = <0x04>;
		pinctrl-names = "default";
		pinctrl-0 = <0x98>;
		clock-names = "baudclk\0apb_pclk";
		interrupts = <0x00 0x7c 0x04>;
		clocks = <0x0e 0x13b 0x0e 0x138>;
		compatible = "rockchip,rk3568-uart\0snps,dw-apb-uart";
		status = "disabled";
		reg = <0x00 0xfe6c0000 0x00 0x100>;
		phandle = <0x123>;
		dmas = <0x25 0x10 0x25 0x11>;
		reg-shift = <0x02>;
	};

	sata@fc800000 {
		power-domains = <0x10 0x0f>;
		phy-names = "sata-phy";
		clock-names = "sata\0pmalive\0rxoob";
		interrupts = <0x00 0x60 0x04>;
		clocks = <0x0e 0xa0 0x0e 0xa1 0x0e 0xa2>;
		compatible = "rockchip,rk3568-dwc-ahci\0snps,dwc-ahci";
		status = "disabled";
		phys = <0x11 0x01>;
		reg = <0x00 0xfc800000 0x00 0x1000>;
		phandle = <0xdf>;
		ports-implemented = <0x01>;
	};

	usb@fd8c0000 {
		phy-names = "usb";
		interrupts = <0x00 0x86 0x04>;
		clocks = <0x0e 0xbf 0x0e 0xc0 0x0e 0xbc>;
		compatible = "generic-ohci";
		status = "okay";
		phys = <0x16>;
		reg = <0x00 0xfd8c0000 0x00 0x40000>;
		phandle = <0xe5>;
	};

	qos@fe158100 {
		compatible = "rockchip,rk3568-qos\0syscon";
		reg = <0x00 0xfe158100 0x00 0x20>;
		phandle = <0x33>;
	};

	pwm@fe6e0020 {
		pinctrl-names = "default";
		pinctrl-0 = <0xa3>;
		clock-names = "pwm\0pclk";
		clocks = <0x0e 0x15a 0x0e 0x159>;
		#pwm-cells = <0x03>;
		compatible = "rockchip,rk3568-pwm\0rockchip,rk3328-pwm";
		status = "disabled";
		reg = <0x00 0xfe6e0020 0x00 0x10>;
		phandle = <0x12e>;
	};

	binman {
		multiple-images;
		phandle = <0x147>;

		simple-bin {
			filename = "u-boot-rockchip.bin";
			pad-byte = <0xff>;

			fit {
				fit,fdt-list = "of-list";
				#address-cells = <0x01>;
				description = "FIT image for U-Boot with bl31 (TF-A)";
				fit,align = <0x200>;
				filename = "u-boot.itb";
				offset = <0x7f8000>;
				fit,external-offset = <0x00>;
				phandle = <0x148>;

				images {

					@tee-SEQ {
						description = "TEE";
						os = "tee";
						fit,data;
						type = "tee";
						fit,entry;
						arch = "arm64";
						fit,load;
						fit,operation = "split-elf";
						compression = "none";

						tee-os {
							optional;
						};

						hash {
							algo = "sha256";
						};
					};

					@fdt-SEQ {
						description = "fdt-NAME";
						type = "flat_dt";
						compression = "none";

						hash {
							algo = "sha256";
						};
					};

					u-boot {
						description = "U-Boot";
						load = <0xa00000>;
						os = "U-Boot";
						type = "standalone";
						arch = "arm64";
						entry = <0xa00000>;
						compression = "none";

						hash {
							algo = "sha256";
						};

						u-boot-nodtb {
						};
					};

					@atf-SEQ {
						description = "ARM Trusted Firmware";
						os = "arm-trusted-firmware";
						fit,data;
						type = "firmware";
						fit,entry;
						arch = "arm64";
						fit,load;
						fit,operation = "split-elf";
						compression = "none";

						hash {
							algo = "sha256";
						};

						atf-bl31 {
						};
					};
				};

				configurations {
					default = "@config-DEFAULT-SEQ";

					@config-SEQ {
						fit,loadables;
						description = "NAME.dtb";
						fit,firmware = "atf-1\0u-boot";
						fdt = "fdt-SEQ";
					};
				};
			};

			mkimage {
				filename = "idbloader.img";
				multiple-data-files;
				args = "-n\0rk3568\0-T\0rksd";

				u-boot-spl {
				};

				rockchip-tpl {
				};
			};
		};
	};

	usb@fd000000 {
		power-domains = <0x10 0x0f>;
		phy-names = "usb2-phy\0usb3-phy";
		clock-names = "ref_clk\0suspend_clk\0bus_clk";
		phy_type = "utmi_wide";
		snps,dis_u2_susphy_quirk;
		resets = <0x0e 0x95>;
		interrupts = <0x00 0xaa 0x04>;
		clocks = <0x0e 0xa9 0x0e 0xaa 0x0e 0xa8>;
		compatible = "rockchip,rk3568-dwc3\0snps,dwc3";
		status = "okay";
		phys = <0x14 0x0f 0x04>;
		reg = <0x00 0xfd000000 0x00 0x400000>;
		phandle = <0xe1>;
		dr_mode = "host";
	};

	qos@fe150000 {
		compatible = "rockchip,rk3568-qos\0syscon";
		reg = <0x00 0xfe150000 0x00 0x20>;
		phandle = <0x38>;
	};

	aliases {
		i2c3 = "/i2c@fe5c0000";
		ethernet0 = "/ethernet@fe2a0000";
		spi2 = "/spi@fe630000";
		gpio0 = "/pinctrl/gpio@fdd60000";
		serial7 = "/serial@fe6b0000";
		i2c1 = "/i2c@fe5a0000";
		spi0 = "/spi@fe610000";
		serial5 = "/serial@fe690000";
		mmc1 = "/mmc@fe2b0000";
		serial3 = "/serial@fe670000";
		serial1 = "/serial@fe650000";
		gpio3 = "/pinctrl/gpio@fe760000";
		i2c4 = "/i2c@fe5d0000";
		ethernet1 = "/ethernet@fe010000";
		spi3 = "/spi@fe640000";
		gpio1 = "/pinctrl/gpio@fe740000";
		serial8 = "/serial@fe6c0000";
		i2c2 = "/i2c@fe5b0000";
		spi1 = "/spi@fe620000";
		serial6 = "/serial@fe6a0000";
		i2c0 = "/i2c@fdd40000";
		mmc2 = "/mmc@fe2c0000";
		serial4 = "/serial@fe680000";
		mmc0 = "/mmc@fe310000";
		serial2 = "/serial@fe660000";
		gpio4 = "/pinctrl/gpio@fe770000";
		i2c5 = "/i2c@fe5e0000";
		serial0 = "/serial@fdd50000";
		spi4 = "/spi@fe300000";
		gpio2 = "/pinctrl/gpio@fe750000";
		serial9 = "/serial@fe6d0000";
	};

	pwm@fe6e0010 {
		pinctrl-names = "default";
		pinctrl-0 = <0xa2>;
		clock-names = "pwm\0pclk";
		clocks = <0x0e 0x15a 0x0e 0x159>;
		#pwm-cells = <0x03>;
		compatible = "rockchip,rk3568-pwm\0rockchip,rk3328-pwm";
		status = "disabled";
		reg = <0x00 0xfe6e0010 0x00 0x10>;
		phandle = <0x12d>;
	};

	qos@fe148000 {
		compatible = "rockchip,rk3568-qos\0syscon";
		reg = <0x00 0xfe148000 0x00 0x20>;
		phandle = <0x2c>;
	};

	nandc@fe330000 {
		#address-cells = <0x01>;
		clock-names = "clk_nandc\0hclk_nandc";
		nandc_id = <0x00>;
		interrupts = <0x00 0x46 0x04>;
		clocks = <0x0e 0x75 0x0e 0x74>;
		#size-cells = <0x00>;
		compatible = "rockchip,rk-nandc";
		status = "okay";
		reg = <0x00 0xfe330000 0x00 0x4000>;
		phandle = <0x144>;

		nand@0 {
			nand-ecc-step-size = <0x400>;
			reg = <0x00>;
			nand-ecc-mode = "hw";
			nand-ecc-strength = <0x10>;
		};
	};

	firmware {

		scmi {
			shmem = <0x06>;
			#address-cells = <0x01>;
			#size-cells = <0x00>;
			compatible = "arm,scmi-smc";
			phandle = <0xdb>;
			arm,smc-id = <0x82000010>;

			protocol@14 {
				#clock-cells = <0x01>;
				reg = <0x14>;
				phandle = <0x02>;
			};
		};
	};

	serial@fe650000 {
		reg-io-width = <0x04>;
		pinctrl-names = "default";
		pinctrl-0 = <0x91>;
		clock-names = "baudclk\0apb_pclk";
		interrupts = <0x00 0x75 0x04>;
		clocks = <0x0e 0x11f 0x0e 0x11c>;
		compatible = "rockchip,rk3568-uart\0snps,dw-apb-uart";
		status = "disabled";
		reg = <0x00 0xfe650000 0x00 0x100>;
		phandle = <0x11c>;
		dmas = <0x25 0x02 0x25 0x03>;
		reg-shift = <0x02>;
	};

	rk809-sound {
		simple-audio-card,name = "Analog RK809";
		simple-audio-card,format = "i2s";
		compatible = "simple-audio-card";
		simple-audio-card,mclk-fs = <0x100>;

		simple-audio-card,cpu {
			sound-dai = <0xcf>;
		};

		simple-audio-card,codec {
			sound-dai = <0xd0>;
		};
	};

	qos@fe190000 {
		compatible = "rockchip,rk3568-qos\0syscon";
		reg = <0x00 0xfe190000 0x00 0x20>;
		phandle = <0x3d>;
	};

	pwm@fe6e0000 {
		pinctrl-names = "default";
		pinctrl-0 = <0xa1>;
		clock-names = "pwm\0pclk";
		clocks = <0x0e 0x15a 0x0e 0x159>;
		#pwm-cells = <0x03>;
		compatible = "rockchip,rk3568-pwm\0rockchip,rk3328-pwm";
		status = "disabled";
		reg = <0x00 0xfe6e0000 0x00 0x10>;
		phandle = <0x12c>;
	};

	pwm@fe700030 {
		pinctrl-names = "default";
		pinctrl-0 = <0xac>;
		clock-names = "pwm\0pclk";
		clocks = <0x0e 0x160 0x0e 0x15f>;
		#pwm-cells = <0x03>;
		compatible = "rockchip,rk3568-pwm\0rockchip,rk3328-pwm";
		status = "disabled";
		reg = <0x00 0xfe700030 0x00 0x10>;
		phandle = <0x137>;
	};

	serial@fe690000 {
		reg-io-width = <0x04>;
		pinctrl-names = "default";
		pinctrl-0 = <0x95>;
		clock-names = "baudclk\0apb_pclk";
		interrupts = <0x00 0x79 0x04>;
		clocks = <0x0e 0x12f 0x0e 0x12c>;
		compatible = "rockchip,rk3568-uart\0snps,dw-apb-uart";
		status = "disabled";
		reg = <0x00 0xfe690000 0x00 0x100>;
		phandle = <0x120>;
		dmas = <0x25 0x0a 0x25 0x0b>;
		reg-shift = <0x02>;
	};

	pcie@fe260000 {
		power-domains = <0x10 0x0f>;
		#address-cells = <0x03>;
		phy-names = "pcie-phy";
		bus-range = <0x00 0x0f>;
		clock-names = "aclk_mst\0aclk_slv\0aclk_dbi\0pclk\0aux";
		reg-names = "dbi\0apb\0config";
		num-ob-windows = <0x02>;
		resets = <0x0e 0xa1>;
		interrupts = <0x00 0x4b 0x04 0x00 0x4a 0x04 0x00 0x49 0x04 0x00 0x48 0x04 0x00 0x47 0x04>;
		clocks = <0x0e 0x81 0x0e 0x82 0x0e 0x83 0x0e 0x84 0x0e 0x85>;
		interrupt-map = <0x00 0x00 0x00 0x01 0x5e 0x00 0x00 0x00 0x00 0x02 0x5e 0x01 0x00 0x00 0x00 0x03 0x5e 0x02 0x00 0x00 0x00 0x04 0x5e 0x03>;
		#size-cells = <0x02>;
		max-link-speed = <0x02>;
		device_type = "pci";
		interrupt-map-mask = <0x00 0x00 0x00 0x07>;
		num-lanes = <0x01>;
		compatible = "rockchip,rk3568-pcie";
		ranges = <0x1000000 0x00 0xf4100000 0x00 0xf4100000 0x00 0x100000 0x2000000 0x00 0xf4200000 0x00 0xf4200000 0x00 0x1e00000 0x3000000 0x00 0x40000000 0x03 0x00 0x00 0x40000000>;
		msi-map = <0x00 0x01 0x00 0x1000>;
		#interrupt-cells = <0x01>;
		status = "disabled";
		interrupt-names = "sys\0pmc\0msi\0legacy\0err";
		phys = <0x11 0x02>;
		reg = <0x03 0xc0000000 0x00 0x400000 0x00 0xfe260000 0x00 0x10000 0x00 0xf4000000 0x00 0x100000>;
		linux,pci-domain = <0x00>;
		phandle = <0x106>;
		reset-names = "pipe";
		num-ib-windows = <0x06>;

		legacy-interrupt-controller {
			#address-cells = <0x00>;
			interrupts = <0x00 0x48 0x01>;
			interrupt-parent = <0x01>;
			#interrupt-cells = <0x01>;
			phandle = <0x5e>;
			interrupt-controller;
		};
	};

	i2c@fdd40000 {
		pinctrl-names = "default";
		#address-cells = <0x01>;
		pinctrl-0 = <0x1f>;
		clock-names = "i2c\0pclk";
		interrupts = <0x00 0x2e 0x04>;
		clocks = <0x1e 0x07 0x1e 0x2d>;
		#size-cells = <0x00>;
		compatible = "rockchip,rk3568-i2c\0rockchip,rk3399-i2c";
		status = "okay";
		reg = <0x00 0xfdd40000 0x00 0x1000>;
		phandle = <0xe7>;

		regulator@1c {
			regulator-max-microvolt = <0x118c30>;
			regulator-boot-on;
			regulator-always-on;
			regulator-min-microvolt = "\0\f5";
			regulator-name = "vdd_cpu";
			regulator-ramp-delay = <0x8fc>;
			fcs,suspend-voltage-selector = <0x01>;
			compatible = "tcs,tcs4525";
			reg = <0x1c>;
			phandle = <0x04>;
			vin-supply = <0x20>;

			regulator-state-mem {
				regulator-off-in-suspend;
			};
		};

		pmic@20 {
			pinctrl-names = "default";
			rockchip,system-power-controller;
			pinctrl-0 = <0x22 0x23>;
			clock-names = "mclk";
			assigned-clocks = <0x0e 0x48>;
			assigned-clock-parents = <0x0e 0x196>;
			wakeup-source;
			interrupts = <0x03 0x08>;
			clocks = <0x0e 0x48>;
			#clock-cells = <0x01>;
			interrupt-parent = <0x21>;
			vcc1-supply = <0x24>;
			#sound-dai-cells = <0x00>;
			vcc2-supply = <0x24>;
			compatible = "rockchip,rk809";
			vcc3-supply = <0x24>;
			vcc4-supply = <0x24>;
			vcc5-supply = <0x24>;
			reg = <0x20>;
			phandle = <0xd0>;
			vcc6-supply = <0x24>;
			vcc7-supply = <0x24>;
			vcc8-supply = <0x24>;
			vcc9-supply = <0x24>;

			regulators {

				DCDC_REG4 {
					regulator-max-microvolt = <0x149970>;
					regulator-init-microvolt = <0xdbba0>;
					regulator-min-microvolt = <0x7a120>;
					regulator-name = "vdd_npu";
					regulator-ramp-delay = <0x1771>;
					regulator-initial-mode = <0x02>;
					phandle = <0xea>;

					regulator-state-mem {
						regulator-off-in-suspend;
					};
				};

				LDO_REG4 {
					regulator-max-microvolt = <0x325aa0>;
					regulator-always-on;
					regulator-min-microvolt = <0x325aa0>;
					regulator-name = "vccio_acodec";
					phandle = <0x18>;

					regulator-state-mem {
						regulator-off-in-suspend;
					};
				};

				DCDC_REG2 {
					regulator-max-microvolt = <0x149970>;
					regulator-init-microvolt = <0xdbba0>;
					regulator-always-on;
					regulator-min-microvolt = <0x7a120>;
					regulator-name = "vdd_gpu";
					regulator-ramp-delay = <0x1771>;
					regulator-initial-mode = <0x02>;
					phandle = <0x46>;

					regulator-state-mem {
						regulator-off-in-suspend;
					};
				};

				LDO_REG2 {
					regulator-max-microvolt = <0xdbba0>;
					regulator-boot-on;
					regulator-always-on;
					regulator-min-microvolt = <0xdbba0>;
					regulator-name = "vdda_0v9";
					phandle = <0xeb>;

					regulator-state-mem {
						regulator-off-in-suspend;
					};
				};

				LDO_REG9 {
					regulator-max-microvolt = <0x1b7740>;
					regulator-min-microvolt = <0x1b7740>;
					regulator-name = "vcca1v8_image";
					phandle = <0x5b>;

					regulator-state-mem {
						regulator-off-in-suspend;
					};
				};

				SWITCH_REG1 {
					regulator-boot-on;
					regulator-always-on;
					regulator-name = "vcc_3v3";
					phandle = <0x1b>;

					regulator-state-mem {
						regulator-off-in-suspend;
					};
				};

				LDO_REG7 {
					regulator-max-microvolt = <0x1b7740>;
					regulator-boot-on;
					regulator-always-on;
					regulator-min-microvolt = <0x1b7740>;
					regulator-name = "vcca_1v8";
					phandle = <0xa0>;

					regulator-state-mem {
						regulator-off-in-suspend;
					};
				};

				DCDC_REG5 {
					regulator-max-microvolt = <0x1b7740>;
					regulator-boot-on;
					regulator-always-on;
					regulator-min-microvolt = <0x1b7740>;
					regulator-name = "vcc_1v8";
					phandle = <0x19>;

					regulator-state-mem {
						regulator-off-in-suspend;
					};
				};

				LDO_REG5 {
					regulator-max-microvolt = <0x325aa0>;
					regulator-min-microvolt = <0x1b7740>;
					regulator-name = "vccio_sd";
					phandle = <0x1a>;

					regulator-state-mem {
						regulator-off-in-suspend;
					};
				};

				DCDC_REG3 {
					regulator-boot-on;
					regulator-always-on;
					regulator-name = "vcc_ddr";
					regulator-initial-mode = <0x02>;
					phandle = <0xe9>;

					regulator-state-mem {
						regulator-on-in-suspend;
					};
				};

				LDO_REG3 {
					regulator-max-microvolt = <0xdbba0>;
					regulator-boot-on;
					regulator-always-on;
					regulator-min-microvolt = <0xdbba0>;
					regulator-name = "vdda0v9_pmu";
					phandle = <0xec>;

					regulator-state-mem {
						regulator-suspend-microvolt = <0xdbba0>;
						regulator-on-in-suspend;
					};
				};

				DCDC_REG1 {
					regulator-max-microvolt = <0x149970>;
					regulator-boot-on;
					regulator-init-microvolt = <0xdbba0>;
					regulator-always-on;
					regulator-min-microvolt = <0x7a120>;
					regulator-name = "vdd_logic";
					regulator-ramp-delay = <0x1771>;
					regulator-initial-mode = <0x02>;
					phandle = <0xe8>;

					regulator-state-mem {
						regulator-off-in-suspend;
					};
				};

				LDO_REG1 {
					regulator-max-microvolt = <0xdbba0>;
					regulator-min-microvolt = <0xdbba0>;
					regulator-name = "vdda0v9_image";
					phandle = <0x5a>;

					regulator-state-mem {
						regulator-off-in-suspend;
					};
				};

				SWITCH_REG2 {
					regulator-name = "vcc3v3_sd";
					phandle = <0x63>;

					regulator-state-mem {
						regulator-off-in-suspend;
					};
				};

				LDO_REG8 {
					regulator-max-microvolt = <0x1b7740>;
					regulator-boot-on;
					regulator-always-on;
					regulator-min-microvolt = <0x1b7740>;
					regulator-name = "vcca1v8_pmu";
					phandle = <0xed>;

					regulator-state-mem {
						regulator-suspend-microvolt = <0x1b7740>;
						regulator-on-in-suspend;
					};
				};

				LDO_REG6 {
					regulator-max-microvolt = <0x325aa0>;
					regulator-boot-on;
					regulator-always-on;
					regulator-min-microvolt = <0x325aa0>;
					regulator-name = "vcc3v3_pmu";
					phandle = <0x17>;

					regulator-state-mem {
						regulator-suspend-microvolt = <0x325aa0>;
						regulator-on-in-suspend;
					};
				};
			};

			codec {
				mic-in-differential;
			};
		};
	};

	pwm@fdd70030 {
		pinctrl-names = "default";
		pinctrl-0 = <0x2a>;
		clock-names = "pwm\0pclk";
		clocks = <0x1e 0x0d 0x1e 0x30>;
		#pwm-cells = <0x03>;
		compatible = "rockchip,rk3568-pwm\0rockchip,rk3328-pwm";
		status = "disabled";
		reg = <0x00 0xfdd70030 0x00 0x10>;
		phandle = <0xf2>;
	};

	mipi-dphy@fe850000 {
		power-domains = <0x10 0x09>;
		clock-names = "ref\0pclk";
		resets = <0x0e 0x1bb>;
		clocks = <0x1e 0x17 0x0e 0x17a>;
		#phy-cells = <0x00>;
		compatible = "rockchip,rk3568-dsi-dphy";
		status = "disabled";
		reg = <0x00 0xfe850000 0x00 0x10000>;
		phandle = <0x55>;
		reset-names = "apb";
	};

	serial@fdd50000 {
		reg-io-width = <0x04>;
		pinctrl-names = "default";
		pinctrl-0 = <0x26>;
		clock-names = "baudclk\0apb_pclk";
		interrupts = <0x00 0x74 0x04>;
		clocks = <0x1e 0x0b 0x1e 0x2c>;
		compatible = "rockchip,rk3568-uart\0snps,dw-apb-uart";
		status = "disabled";
		reg = <0x00 0xfdd50000 0x00 0x100>;
		phandle = <0xee>;
		dmas = <0x25 0x00 0x25 0x01>;
		reg-shift = <0x02>;
	};

	pwm@fe700020 {
		pinctrl-names = "default";
		pinctrl-0 = <0xab>;
		clock-names = "pwm\0pclk";
		clocks = <0x0e 0x160 0x0e 0x15f>;
		#pwm-cells = <0x03>;
		compatible = "rockchip,rk3568-pwm\0rockchip,rk3328-pwm";
		status = "disabled";
		reg = <0x00 0xfe700020 0x00 0x10>;
		phandle = <0x136>;
	};

	chosen {
		linux,uefi-mmap-size = <0x438>;
		u-boot,version = "2023.10-g166c4089bb-dirty";
		bootargs = "BOOT_IMAGE=/Image root=PARTUUID=228556d6-5062-4d0c-b886-977c8420b1ab rootwait rootfstype=ext4 console=ttyS2,1500000n8";
		linux,uefi-mmap-start = <0x00 0x5a948068>;
		kaslr-seed = <0x00 0x00>;
		linux,uefi-mmap-desc-size = <0x28>;
		u-boot,spl-boot-order = "same-as-spl\0/mmc@fe2b0000\0/mmc@fe310000";
		linux,uefi-mmap-desc-ver = <0x01>;
		phandle = <0x141>;
		linux,uefi-system-table = <0x00 0x7fea2c10>;
		stdout-path = "/serial@fe660000";
	};

	spi@fe610000 {
		pinctrl-names = "default";
		#address-cells = <0x01>;
		pinctrl-0 = <0x85 0x86 0x87>;
		clock-names = "spiclk\0apb_pclk";
		interrupts = <0x00 0x67 0x04>;
		clocks = <0x0e 0x152 0x0e 0x151>;
		#size-cells = <0x00>;
		dma-names = "tx\0rx";
		compatible = "rockchip,rk3568-spi\0rockchip,rk3066-spi";
		status = "disabled";
		reg = <0x00 0xfe610000 0x00 0x1000>;
		phandle = <0x118>;
		dmas = <0x25 0x14 0x25 0x15>;
	};

	pwm@fdd70020 {
		pinctrl-names = "default";
		pinctrl-0 = <0x29>;
		clock-names = "pwm\0pclk";
		clocks = <0x1e 0x0d 0x1e 0x30>;
		#pwm-cells = <0x03>;
		compatible = "rockchip,rk3568-pwm\0rockchip,rk3328-pwm";
		status = "disabled";
		reg = <0x00 0xfdd70020 0x00 0x10>;
		phandle = <0xf1>;
	};

	syscon@fdcb8000 {
		compatible = "rockchip,rk3568-pcie3-phy-grf\0syscon";
		reg = <0x00 0xfdcb8000 0x00 0x10000>;
		phandle = <0xbf>;
	};

	pwm@fe700010 {
		pinctrl-names = "default";
		pinctrl-0 = <0xaa>;
		clock-names = "pwm\0pclk";
		clocks = <0x0e 0x160 0x0e 0x15f>;
		#pwm-cells = <0x03>;
		compatible = "rockchip,rk3568-pwm\0rockchip,rk3328-pwm";
		status = "disabled";
		reg = <0x00 0xfe700010 0x00 0x10>;
		phandle = <0x135>;
	};

	i2c@fe5b0000 {
		pinctrl-names = "default";
		#address-cells = <0x01>;
		pinctrl-0 = <0x81>;
		clock-names = "i2c\0pclk";
		interrupts = <0x00 0x30 0x04>;
		clocks = <0x0e 0x14a 0x0e 0x149>;
		#size-cells = <0x00>;
		compatible = "rockchip,rk3568-i2c\0rockchip,rk3399-i2c";
		status = "disabled";
		reg = <0x00 0xfe5b0000 0x00 0x1000>;
		phandle = <0x113>;
	};

	qos@fe190300 {
		compatible = "rockchip,rk3568-qos\0syscon";
		reg = <0x00 0xfe190300 0x00 0x20>;
		phandle = <0x42>;
	};

	pwm@fdd70010 {
		pinctrl-names = "default";
		pinctrl-0 = <0x28>;
		clock-names = "pwm\0pclk";
		clocks = <0x1e 0x0d 0x1e 0x30>;
		#pwm-cells = <0x03>;
		compatible = "rockchip,rk3568-pwm\0rockchip,rk3328-pwm";
		status = "disabled";
		reg = <0x00 0xfdd70010 0x00 0x10>;
		phandle = <0xf0>;
	};

	pwm@fe700000 {
		pinctrl-names = "default";
		pinctrl-0 = <0xa9>;
		clock-names = "pwm\0pclk";
		clocks = <0x0e 0x160 0x0e 0x15f>;
		#pwm-cells = <0x03>;
		compatible = "rockchip,rk3568-pwm\0rockchip,rk3328-pwm";
		status = "disabled";
		reg = <0x00 0xfe700000 0x00 0x10>;
		phandle = <0x134>;
	};

	vcc3v3-lcd0-n {
		regulator-max-microvolt = <0x325aa0>;
		pinctrl-names = "default";
		gpio = <0x21 0x17 0x00>;
		pinctrl-0 = <0xd5>;
		enable-active-high;
		regulator-min-microvolt = <0x325aa0>;
		regulator-name = "vcc3v3_lcd0_n";
		compatible = "regulator-fixed";
		phandle = <0x7e>;
		vin-supply = <0x24>;

		regulator-state-mem {
			regulator-off-in-suspend;
		};
	};

	vcc5v0-usb {
		regulator-max-microvolt = <0x4c4b40>;
		regulator-boot-on;
		regulator-always-on;
		regulator-min-microvolt = <0x4c4b40>;
		regulator-name = "vcc5v0_usb";
		compatible = "regulator-fixed";
		phandle = <0xd3>;
		vin-supply = <0xd1>;
	};

	syscon@fdc50000 {
		compatible = "rockchip,rk3568-pipe-grf\0syscon";
		reg = <0x00 0xfdc50000 0x00 0x1000>;
		phandle = <0xad>;
	};

	dsi@fe070000 {
		power-domains = <0x10 0x09>;
		phy-names = "dphy";
		clock-names = "pclk";
		resets = <0x0e 0x111>;
		interrupts = <0x00 0x45 0x04>;
		clocks = <0x0e 0xe9>;
		compatible = "rockchip,rk3568-mipi-dsi\0snps,dw-mipi-dsi";
		status = "disabled";
		rockchip,grf = <0x1c>;
		phys = <0x56>;
		reg = <0x00 0xfe070000 0x00 0x10000>;
		phandle = <0x100>;
		reset-names = "apb";

		ports {
			#address-cells = <0x01>;
			#size-cells = <0x00>;

			port@0 {
				reg = <0x00>;
				phandle = <0x101>;
			};

			port@1 {
				reg = <0x01>;
				phandle = <0x102>;
			};
		};
	};

	clock-controller@fdd20000 {
		#reset-cells = <0x01>;
		clock-names = "xin24m";
		assigned-clocks = <0x1e 0x05 0x0e 0x04 0x1e 0x01>;
		assigned-clock-parents = <0x1e 0x08>;
		bootph-all;
		assigned-clock-rates = <0x8000 0x47868c00 0xbebc200>;
		clocks = <0x1d>;
		#clock-cells = <0x01>;
		compatible = "rockchip,rk3568-cru";
		status = "okay";
		rockchip,grf = <0x1c>;
		reg = <0x00 0xfdd20000 0x00 0x1000>;
		phandle = <0x0e>;
	};

	pwm@fdd70000 {
		pinctrl-names = "default";
		pinctrl-0 = <0x27>;
		clock-names = "pwm\0pclk";
		clocks = <0x1e 0x0d 0x1e 0x30>;
		#pwm-cells = <0x03>;
		compatible = "rockchip,rk3568-pwm\0rockchip,rk3328-pwm";
		status = "disabled";
		reg = <0x00 0xfdd70000 0x00 0x10>;
		phandle = <0xef>;
	};

	dc-12v {
		regulator-max-microvolt = <0xb71b00>;
		regulator-boot-on;
		regulator-always-on;
		regulator-min-microvolt = <0xb71b00>;
		regulator-name = "dc_12v";
		compatible = "regulator-fixed";
		phandle = <0xd1>;
	};

	iommu@fdea0800 {
		power-domains = <0x10 0x0b>;
		clock-names = "aclk\0iface";
		interrupts = <0x00 0x8a 0x04>;
		clocks = <0x0e 0xee 0x0e 0xef>;
		#iommu-cells = <0x00>;
		compatible = "rockchip,rk3568-iommu";
		reg = <0x00 0xfdea0800 0x00 0x40>;
		phandle = <0x47>;
	};

	syscon@fdc90000 {
		compatible = "rockchip,rk3568-pipe-phy-grf\0syscon";
		reg = <0x00 0xfdc90000 0x00 0x1000>;
		phandle = <0xaf>;
	};

	mmc@fe2b0000 {
		fifo-depth = <0x100>;
		pinctrl-names = "default";
		pinctrl-0 = <0x5f 0x60 0x61 0x62>;
		clock-names = "biu\0ciu\0ciu-drive\0ciu-sample";
		cap-sd-highspeed;
		vqmmc-supply = <0x1a>;
		bus-width = <0x04>;
		resets = <0x0e 0xd4>;
		interrupts = <0x00 0x62 0x04>;
		clocks = <0x0e 0xb0 0x0e 0xb1 0x0e 0x18a 0x0e 0x18b>;
		vmmc-supply = <0x63>;
		compatible = "rockchip,rk3568-dw-mshc\0rockchip,rk3288-dw-mshc";
		status = "okay";
		disable-wp;
		reg = <0x00 0xfe2b0000 0x00 0x4000>;
		bootph-pre-ram;
		phandle = <0x107>;
		sd-uhs-sdr104;
		max-frequency = <0x8f0d180>;
		cap-mmc-highspeed;
		reset-names = "reset";
		cd-gpios = <0x21 0x04 0x01>;
	};

	pmu {
		interrupt-affinity = <0x09 0x0a 0x0b 0x0c>;
		interrupts = <0x00 0xe4 0x04 0x00 0xe5 0x04 0x00 0xe6 0x04 0x00 0xe7 0x04>;
		compatible = "arm,cortex-a55-pmu";
	};

	i2s@fe420000 {
		pinctrl-names = "default";
		pinctrl-0 = <0x72 0x73 0x74 0x75>;
		clock-names = "mclk_tx\0mclk_rx\0hclk";
		assigned-clocks = <0x0e 0x4d>;
		assigned-clock-rates = <0x46cf7100>;
		resets = <0x0e 0x54>;
		interrupts = <0x00 0x36 0x04>;
		clocks = <0x0e 0x4f 0x0e 0x4f 0x0e 0x3b>;
		dma-names = "tx\0rx";
		#sound-dai-cells = <0x00>;
		compatible = "rockchip,rk3568-i2s-tdm";
		status = "disabled";
		rockchip,grf = <0x1c>;
		reg = <0x00 0xfe420000 0x00 0x1000>;
		phandle = <0x10d>;
		dmas = <0x65 0x04 0x65 0x05>;
		reset-names = "m";
	};

	qos@fe190280 {
		compatible = "rockchip,rk3568-qos\0syscon";
		reg = <0x00 0xfe190280 0x00 0x20>;
		phandle = <0x41>;
	};

	iommu@fdee0800 {
		power-domains = <0x10 0x0a>;
		clock-names = "aclk\0iface";
		interrupts = <0x00 0x3f 0x04>;
		clocks = <0x0e 0xfd 0x0e 0xfe>;
		#iommu-cells = <0x00>;
		compatible = "rockchip,rk3568-iommu";
		reg = <0x00 0xfdee0800 0x00 0x40>;
		phandle = <0x48>;
	};

	cpus {
		#address-cells = <0x02>;
		#size-cells = <0x00>;

		cpu@300 {
			cpu-supply = <0x04>;
			device_type = "cpu";
			compatible = "arm,cortex-a55";
			reg = <0x00 0x300>;
			enable-method = "psci";
			phandle = <0x0c>;
			operating-points-v2 = <0x03>;
			#cooling-cells = <0x02>;
		};

		cpu@200 {
			cpu-supply = <0x04>;
			device_type = "cpu";
			compatible = "arm,cortex-a55";
			reg = <0x00 0x200>;
			enable-method = "psci";
			phandle = <0x0b>;
			operating-points-v2 = <0x03>;
			#cooling-cells = <0x02>;
		};

		cpu@0 {
			cpu-supply = <0x04>;
			clocks = <0x02 0x00>;
			device_type = "cpu";
			compatible = "arm,cortex-a55";
			reg = <0x00 0x00>;
			enable-method = "psci";
			phandle = <0x09>;
			operating-points-v2 = <0x03>;
			#cooling-cells = <0x02>;
		};

		cpu@100 {
			cpu-supply = <0x04>;
			device_type = "cpu";
			compatible = "arm,cortex-a55";
			reg = <0x00 0x100>;
			enable-method = "psci";
			phandle = <0x0a>;
			operating-points-v2 = <0x03>;
			#cooling-cells = <0x02>;
		};
	};

	__symbols__ {
		vcc5v0_usb_host_en = "/pinctrl/usb/vcc5v0_usb_host_en";
		i2c3 = "/i2c@fe5c0000";
		scmi_shmem = "/sram@10f000/sram@0";
		pdmm0_sdi3 = "/pinctrl/pdm/pdmm0-sdi3";
		usb_host1_ohci = "/usb@fd8c0000";
		pwm9 = "/pwm@fe6f0010";
		qos_usb3_1 = "/qos@fe190400";
		gmac0_rgmii_bus = "/pinctrl/gmac0/gmac0-rgmii-bus";
		dc_12v = "/dc-12v";
		pcie3x2 = "/pcie@fe280000";
		vccio_acodec = "/i2c@fdd40000/pmic@20/regulators/LDO_REG4";
		pwm14 = "/pwm@fe700020";
		cpu_crit = "/thermal-zones/cpu-thermal/trips/cpu_crit";
		thermal_zones = "/thermal-zones";
		qos_gpu = "/qos@fe128000";
		qos_iep = "/qos@fe158100";
		pcfg_pull_none_drv_level_3 = "/pinctrl/pcfg-pull-none-drv-level-3";
		vp1 = "/vop@fe040000/ports/port@1";
		uart8 = "/serial@fe6c0000";
		qos_vop_m1 = "/qos@fe1a8100";
		pcfg_pull_none_smt = "/pinctrl/pcfg-pull-none-smt";
		vp0_out_hdmi = "/vop@fe040000/ports/port@0/endpoint@2";
		qos_ebc = "/qos@fe158000";
		spi2 = "/spi@fe630000";
		gpio0 = "/pinctrl/gpio@fdd60000";
		saradc = "/saradc@fe720000";
		i2s1m0_sdi3 = "/pinctrl/i2s1/i2s1m0-sdi3";
		dsi1 = "/dsi@fe070000";
		usb2phy1 = "/usb2phy@fe8b0000";
		gmac0_miim = "/pinctrl/gmac0/gmac0-miim";
		spi3m0_cs0 = "/pinctrl/spi3/spi3m0-cs0";
		crypto = "/crypto@fe380000";
		pcfg_pull_up_drv_level_2 = "/pinctrl/pcfg-pull-up-drv-level-2";
		pinctrl = "/pinctrl";
		rgmii_phy0 = "/ethernet@fe2a0000/mdio/ethernet-phy@0";
		pdmm0_clk = "/pinctrl/pdm/pdmm0-clk";
		qos_isp = "/qos@fe148000";
		pdm = "/pdm@fe440000";
		vdd_logic = "/i2c@fdd40000/pmic@20/regulators/DCDC_REG1";
		i2c1 = "/i2c@fe5a0000";
		qos_rkvenc_rd_m0 = "/qos@fe138080";
		pdmm0_sdi1 = "/pinctrl/pdm/pdmm0-sdi1";
		pwm7 = "/pwm@fe6e0030";
		i2s2m0_sclktx = "/pinctrl/i2s2/i2s2m0-sclktx";
		gmac0 = "/ethernet@fe2a0000";
		sdmmc0_clk = "/pinctrl/sdmmc0/sdmmc0-clk";
		pwm3_pins = "/pinctrl/pwm3/pwm3-pins";
		pwm12 = "/pwm@fe700000";
		i2s1_8ch = "/i2s@fe410000";
		csi_dphy = "/phy@fe870000";
		pcfg_pull_none = "/pinctrl/pcfg-pull-none";
		i2s1m0_mclk = "/pinctrl/i2s1/i2s1m0-mclk";
		spi_nor = "/spi@fe300000/flash@1";
		vdd_npu = "/i2c@fdd40000/pmic@20/regulators/DCDC_REG4";
		touch_rst = "/pinctrl/touchscreen/touch_rst";
		clk32k_out0 = "/pinctrl/clk32k/clk32k-out0";
		qos_rga_wr = "/qos@fe158300";
		pcfg_pull_none_drv_level_1 = "/pinctrl/pcfg-pull-none-drv-level-1";
		hdmi_con_in = "/hdmi-con/port/endpoint";
		uart6 = "/serial@fe6a0000";
		sdhci = "/mmc@fe310000";
		i2s2m0_sdo = "/pinctrl/i2s2/i2s2m0-sdo";
		nandc0 = "/nandc@fe330000";
		secure_otp = "/secure_otp@fe3a0000";
		gpu = "/gpu@fde60000";
		spi0 = "/spi@fe610000";
		i2s1m0_sdi1 = "/pinctrl/i2s1/i2s1m0-sdi1";
		usb_host0_ohci = "/usb@fd840000";
		pcie30phy = "/phy@fe8c0000";
		dmc = "/dmc";
		scmi = "/firmware/scmi";
		vcc3v3_lcd1_n = "/vcc3v3-lcd1-n";
		pwm0m0_pins = "/pinctrl/pwm0/pwm0m0-pins";
		vcc3v3_lcd1_n_en = "/pinctrl/display/vcc3v3_lcd1_n_en";
		pmugrf = "/syscon@fdc20000";
		i2s2_2ch = "/i2s@fe420000";
		pwm5 = "/pwm@fe6e0010";
		uart1m0_xfer = "/pinctrl/uart1/uart1m0-xfer";
		gmac1m1_miim = "/pinctrl/gmac1/gmac1m1-miim";
		pwm10 = "/pwm@fe6f0020";
		tsadc_pin = "/pinctrl/tsadc/tsadc-pin";
		vcc5v0_usb_otg_en = "/pinctrl/usb/vcc5v0_usb_otg_en";
		pipe_phy_grf2 = "/syscon@fdc90000";
		gpu_crit = "/thermal-zones/gpu-thermal/trips/gpu-crit";
		uart4 = "/serial@fe680000";
		pwm1m0_pins = "/pinctrl/pwm1/pwm1m0-pins";
		spi0m0_cs0 = "/pinctrl/spi0/spi0m0-cs0";
		qos_sata2 = "/qos@fe190300";
		dsi_dphy1 = "/mipi-dphy@fe860000";
		spi2m0_cs1 = "/pinctrl/spi2/spi2m0-cs1";
		uart2m0_xfer = "/pinctrl/uart2/uart2m0-xfer";
		vdd_gpu = "/i2c@fdd40000/pmic@20/regulators/DCDC_REG2";
		xin32k = "/xin32k";
		cpu0_opp_table = "/opp-table-0";
		cpu_alert0 = "/thermal-zones/cpu-thermal/trips/cpu_alert0";
		qos_vicap0 = "/qos@fe148080";
		qos_vpu = "/qos@fe150000";
		usb2phy0_otg = "/usb2phy@fe8a0000/otg-port";
		cpu_thermal = "/thermal-zones/cpu-thermal";
		vdda0v9_image = "/i2c@fdd40000/pmic@20/regulators/LDO_REG1";
		qos_pcie2x1 = "/qos@fe190000";
		power = "/power-management@fdd90000/power-controller";
		pcie30_3v3 = "/gpio-regulator";
		dsi0_out = "/dsi@fe060000/ports/port@1";
		pwm2m0_pins = "/pinctrl/pwm2/pwm2m0-pins";
		pwm3 = "/pwm@fdd70030";
		gmac0_tx_bus2 = "/pinctrl/gmac0/gmac0-tx-bus2";
		sata2 = "/sata@fc800000";
		uart3m0_xfer = "/pinctrl/uart3/uart3m0-xfer";
		usb2phy0_grf = "/syscon@fdca0000";
		combphy1 = "/phy@fe830000";
		scmi_clk = "/firmware/scmi/protocol@14";
		cru = "/clock-controller@fdd20000";
		pipe_phy_grf0 = "/syscon@fdc70000";
		cpu3 = "/cpus/cpu@300";
		gmac1_stmmac_axi_setup = "/ethernet@fe010000/stmmac-axi-config";
		pdmm0_clk1 = "/pinctrl/pdm/pdmm0-clk1";
		uart2 = "/serial@fe660000";
		dmac0 = "/dma-controller@fe530000";
		qos_sata0 = "/qos@fe190200";
		sdio_pwrseq = "/sdio-pwrseq";
		vcc3v3_lcd0_n_en = "/pinctrl/display/vcc3v3_lcd0_n_en";
		vcc5v0_usb_host = "/vcc5v0-usb-host";
		otp = "/nvmem@fe38c000";
		uart4m0_xfer = "/pinctrl/uart4/uart4m0-xfer";
		qos_rkvenc_wr_m0 = "/qos@fe138180";
		pmu_io_domains = "/syscon@fdc20000/io-domains";
		usb2phy1_host = "/usb2phy@fe8b0000/host-port";
		vcc3v3_sd = "/i2c@fdd40000/pmic@20/regulators/SWITCH_REG2";
		gic = "/interrupt-controller@fd400000";
		pipegrf = "/syscon@fdc50000";
		sdmmc1 = "/mmc@fe2c0000";
		pwm1 = "/pwm@fdd70010";
		cpu_id = "/nvmem@fe38c000/id@a";
		gmac0_mtl_rx_setup = "/ethernet@fe2a0000/rx-queues-config";
		vpu = "/video-codec@fdea0400";
		sata0 = "/sata@fc000000";
		uart5m0_xfer = "/pinctrl/uart5/uart5m0-xfer";
		usb_host1_ehci = "/usb@fd880000";
		xin24m = "/xin24m";
		tsadc = "/tsadc@fe710000";
		mdio1 = "/ethernet@fe010000/mdio";
		gpio3 = "/pinctrl/gpio@fe760000";
		gpu_opp_table = "/opp-table-1";
		cpu1 = "/cpus/cpu@100";
		vdpu_mmu = "/iommu@fdea0800";
		i2c2m0_xfer = "/pinctrl/i2c2/i2c2m0-xfer";
		uart0 = "/serial@fdd50000";
		qos_pcie3x2 = "/qos@fe190100";
		i2s2m0_sdi = "/pinctrl/i2s2/i2s2m0-sdi";
		dsi1_in = "/dsi@fe070000/ports/port@0";
		i2s1m0_sdo2 = "/pinctrl/i2s1/i2s1m0-sdo2";
		qos_hdcp = "/qos@fe1a8000";
		i2c4 = "/i2c@fe5d0000";
		i2s3_2ch = "/i2s@fe430000";
		uart6m0_xfer = "/pinctrl/uart6/uart6m0-xfer";
		vcc3v3_pmu = "/i2c@fdd40000/pmic@20/regulators/LDO_REG6";
		led_work_en = "/pinctrl/leds/led_work_en";
		vdd_cpu = "/i2c@fdd40000/regulator@1c";
		qos_jpeg_dec = "/qos@fe158180";
		pwm15 = "/pwm@fe700030";
		vop_mmu = "/iommu@fe043e00";
		gmac1m1_tx_bus2 = "/pinctrl/gmac1/gmac1m1-tx-bus2";
		sdmmc0_det = "/pinctrl/sdmmc0/sdmmc0-det";
		vcc3v3_lcd0_n = "/vcc3v3-lcd0-n";
		i2c3m0_xfer = "/pinctrl/i2c3/i2c3m0-xfer";
		spdif = "/spdif@fe460000";
		gmac1m1_rgmii_bus = "/pinctrl/gmac1/gmac1m1-rgmii-bus";
		pwm7_pins = "/pinctrl/pwm7/pwm7-pins";
		vp2 = "/vop@fe040000/ports/port@2";
		gmac0_mtl_tx_setup = "/ethernet@fe2a0000/tx-queues-config";
		rng = "/rng@fe388000";
		uart9 = "/serial@fe6d0000";
		wifi_enable_h = "/pinctrl/sdio-pwrseq/wifi-enable-h";
		gmac0_rgmii_clk = "/pinctrl/gmac0/gmac0-rgmii-clk";
		uart7m0_xfer = "/pinctrl/uart7/uart7m0-xfer";
		spi3 = "/spi@fe640000";
		gpio1 = "/pinctrl/gpio@fe740000";
		spi1m0_cs0 = "/pinctrl/spi1/spi1m0-cs0";
		usb2phy0_host = "/usb2phy@fe8a0000/host-port";
		spi3m0_cs1 = "/pinctrl/spi3/spi3m0-cs1";
		vcc5v0_sys = "/vcc5v0-sys";
		vdda0v9_pmu = "/i2c@fdd40000/pmic@20/regulators/LDO_REG3";
		rgmii_phy1 = "/ethernet@fe010000/mdio/ethernet-phy@0";
		i2c4m0_xfer = "/pinctrl/i2c4/i2c4m0-xfer";
		wdt = "/watchdog@fe600000";
		hdmi_out = "/hdmi@fe0a0000/ports/port@1";
		usb2phy1_otg = "/usb2phy@fe8b0000/otg-port";
		vdda_0v9 = "/i2c@fdd40000/pmic@20/regulators/LDO_REG2";
		qos_rga_rd = "/qos@fe158280";
		i2s1m0_sdo0 = "/pinctrl/i2s1/i2s1m0-sdo0";
		hdmitx_scl = "/pinctrl/hdmitx/hdmitx-scl";
		hdmitx_sda = "/pinctrl/hdmitx/hdmitx-sda";
		dsi1_out = "/dsi@fe070000/ports/port@1";
		i2c2 = "/i2c@fe5b0000";
		qos_rkvenc_rd_m1 = "/qos@fe138100";
		pdmm0_sdi2 = "/pinctrl/pdm/pdmm0-sdi2";
		pwm8 = "/pwm@fe6f0000";
		qos_usb3_0 = "/qos@fe190380";
		uart8m0_xfer = "/pinctrl/uart8/uart8m0-xfer";
		pcie3x1 = "/pcie@fe270000";
		usb_host0_ehci = "/usb@fd800000";
		gmac1 = "/ethernet@fe010000";
		usb2phy1_grf = "/syscon@fdca8000";
		pwm13 = "/pwm@fe700010";
		tsadc_shutorg = "/pinctrl/tsadc/tsadc-shutorg";
		i2c5m0_xfer = "/pinctrl/i2c5/i2c5m0-xfer";
		fspi_pins = "/pinctrl/fspi/fspi-pins";
		pcfg_pull_none_drv_level_2 = "/pinctrl/pcfg-pull-none-drv-level-2";
		vp0 = "/vop@fe040000/ports/port@0";
		i2c1_xfer = "/pinctrl/i2c1/i2c1-xfer";
		uart7 = "/serial@fe6b0000";
		qos_vop_m0 = "/qos@fe1a8080";
		pmucru = "/clock-controller@fdd00000";
		pwm8m0_pins = "/pinctrl/pwm8/pwm8m0-pins";
		pmic_int = "/pinctrl/pmic/pmic_int";
		spi0m0_pins = "/pinctrl/spi0/spi0m0-pins";
		vcc_ddr = "/i2c@fdd40000/pmic@20/regulators/DCDC_REG3";
		sfc = "/spi@fe300000";
		spi1 = "/spi@fe620000";
		hdmi_out_con = "/hdmi@fe0a0000/ports/port@1/endpoint";
		uart9m0_xfer = "/pinctrl/uart9/uart9m0-xfer";
		i2s1m0_sdi2 = "/pinctrl/i2s1/i2s1m0-sdi2";
		sdmmc0_bus4 = "/pinctrl/sdmmc0/sdmmc0-bus4";
		dsi0 = "/dsi@fe060000";
		usb2phy0 = "/usb2phy@fe8a0000";
		gpu_threshold = "/thermal-zones/gpu-thermal/trips/gpu-threshold";
		vcc5v0_usb_otg = "/vcc5v0-usb-otg";
		pcfg_pull_up_drv_level_1 = "/pinctrl/pcfg-pull-up-drv-level-1";
		vop_out = "/vop@fe040000/ports";
		i2c0 = "/i2c@fdd40000";
		pwm6_pins = "/pinctrl/pwm6/pwm6-pins";
		pwm9m0_pins = "/pinctrl/pwm9/pwm9m0-pins";
		pdmm0_sdi0 = "/pinctrl/pdm/pdmm0-sdi0";
		pwm6 = "/pwm@fe6e0020";
		spi1m0_pins = "/pinctrl/spi1/spi1m0-pins";
		spdifm0_tx = "/pinctrl/spdif/spdifm0-tx";
		binman = "/binman";
		vcca_1v8 = "/i2c@fdd40000/pmic@20/regulators/LDO_REG7";
		pwm11 = "/pwm@fe6f0030";
		usb_host1_xhci = "/usb@fd000000";
		gpu_target = "/thermal-zones/gpu-thermal/trips/gpu-target";
		uart5 = "/serial@fe690000";
		spi0m0_cs1 = "/pinctrl/spi0/spi0m0-cs1";
		touchscreen0 = "/i2c@fe5a0000/goodix@14";
		spi2m0_pins = "/pinctrl/spi2/spi2m0-pins";
		vepu_mmu = "/iommu@fdee0800";
		gmac1_mtl_rx_setup = "/ethernet@fe010000/rx-queues-config";
		i2s1m0_sdi0 = "/pinctrl/i2s1/i2s1m0-sdi0";
		cpu_alert1 = "/thermal-zones/cpu-thermal/trips/cpu_alert1";
		pwm10m0_pins = "/pinctrl/pwm10/pwm10m0-pins";
		vop = "/vop@fe040000";
		vepu = "/video-codec@fdee0000";
		qos_vicap1 = "/qos@fe148100";
		pcie30_phy_grf = "/syscon@fdcb8000";
		led_work = "/leds/led-0";
		gmac0_rx_bus2 = "/pinctrl/gmac0/gmac0-rx-bus2";
		i2c0_xfer = "/pinctrl/i2c0/i2c0-xfer";
		pwm4 = "/pwm@fe6e0000";
		vcc3v3_sys = "/vcc3v3-sys";
		spi3m0_pins = "/pinctrl/spi3/spi3m0-pins";
		i2s1m0_lrcktx = "/pinctrl/i2s1/i2s1m0-lrcktx";
		vcca1v8_image = "/i2c@fdd40000/pmic@20/regulators/LDO_REG9";
		combphy2 = "/phy@fe840000";
		fit = "/binman/simple-bin/fit";
		vcca1v8_pmu = "/i2c@fdd40000/pmic@20/regulators/LDO_REG8";
		chosen = "/chosen";
		pwm11m0_pins = "/pinctrl/pwm11/pwm11m0-pins";
		touch_int = "/pinctrl/touchscreen/touch_int";
		pipe_phy_grf1 = "/syscon@fdc80000";
		dsi0_in = "/dsi@fe060000/ports/port@0";
		uart3 = "/serial@fe670000";
		pcfg_pull_up = "/pinctrl/pcfg-pull-up";
		dmac1 = "/dma-controller@fe550000";
		qos_sata1 = "/qos@fe190280";
		dsi_dphy0 = "/mipi-dphy@fe850000";
		spi2m0_cs0 = "/pinctrl/spi2/spi2m0-cs0";
		pwm5_pins = "/pinctrl/pwm5/pwm5-pins";
		gmac1_mtl_tx_setup = "/ethernet@fe010000/tx-queues-config";
		i2s1m0_lrckrx = "/pinctrl/i2s1/i2s1m0-lrckrx";
		vccio_sd = "/i2c@fdd40000/pmic@20/regulators/LDO_REG5";
		vcc_1v8 = "/i2c@fdd40000/pmic@20/regulators/DCDC_REG5";
		pwm12m0_pins = "/pinctrl/pwm12/pwm12m0-pins";
		usb_host0_xhci = "/usb@fcc00000";
		pcie3x1_intc = "/pcie@fe270000/legacy-interrupt-controller";
		sdmmc2 = "/mmc@fe000000";
		pwm2 = "/pwm@fdd70020";
		gmac0_stmmac_axi_setup = "/ethernet@fe2a0000/stmmac-axi-config";
		sata1 = "/sata@fc400000";
		display_subsystem = "/display-subsystem";
		combphy0 = "/phy@fe820000";
		i2s0_8ch = "/i2s@fe400000";
		pmu = "/power-management@fdd90000";
		pcie2x1 = "/pcie@fe260000";
		gpio4 = "/pinctrl/gpio@fe770000";
		pwm13m0_pins = "/pinctrl/pwm13/pwm13m0-pins";
		cpu2 = "/cpus/cpu@200";
		hdmitxm0_cec = "/pinctrl/hdmitx/hdmitxm0-cec";
		gpu_thermal = "/thermal-zones/gpu-thermal";
		uart1 = "/serial@fe650000";
		hdmi = "/hdmi@fe0a0000";
		i2s1m0_sclktx = "/pinctrl/i2s1/i2s1m0-sclktx";
		rk809 = "/i2c@fdd40000/pmic@20";
		hdmi_in = "/hdmi@fe0a0000/ports/port@0";
		i2s1m0_sdo3 = "/pinctrl/i2s1/i2s1m0-sdo3";
		i2c5 = "/i2c@fe5e0000";
		qos_rkvdec = "/qos@fe198000";
		spi_nand = "/spi@fe300000/flash@0";
		qos_npu = "/qos@fe180000";
		grf = "/syscon@fdc60000";
		qos_jpeg_enc = "/qos@fe158200";
		gmac1m1_rx_bus2 = "/pinctrl/gmac1/gmac1m1-rx-bus2";
		hdmi_in_vp0 = "/hdmi@fe0a0000/ports/port@0/endpoint";
		sdmmc0_cmd = "/pinctrl/sdmmc0/sdmmc0-cmd";
		pwm14m0_pins = "/pinctrl/pwm14/pwm14m0-pins";
		sdmmc0 = "/mmc@fe2b0000";
		pwm0 = "/pwm@fdd70000";
		i2s1m0_sclkrx = "/pinctrl/i2s1/i2s1m0-sclkrx";
		hdmi_sound = "/hdmi-sound";
		pcie_intc = "/pcie@fe260000/legacy-interrupt-controller";
		vcc_3v3 = "/i2c@fdd40000/pmic@20/regulators/SWITCH_REG1";
		uart0_xfer = "/pinctrl/uart0/uart0-xfer";
		pwm4_pins = "/pinctrl/pwm4/pwm4-pins";
		mdio0 = "/ethernet@fe2a0000/mdio";
		gpio2 = "/pinctrl/gpio@fe750000";
		spi1m0_cs1 = "/pinctrl/spi1/spi1m0-cs1";
		cpu0 = "/cpus/cpu@0";
		gmac1m1_rgmii_clk = "/pinctrl/gmac1/gmac1m1-rgmii-clk";
		pwm15m0_pins = "/pinctrl/pwm15/pwm15m0-pins";
		qos_pcie3x1 = "/qos@fe190080";
		i2s2m0_lrcktx = "/pinctrl/i2s2/i2s2m0-lrcktx";
		i2s1m0_sdo1 = "/pinctrl/i2s1/i2s1m0-sdo1";
		vcc5v0_usb = "/vcc5v0-usb";
	};

	pwm@fe6f0030 {
		pinctrl-names = "default";
		pinctrl-0 = <0xa8>;
		clock-names = "pwm\0pclk";
		clocks = <0x0e 0x15d 0x0e 0x15c>;
		#pwm-cells = <0x03>;
		compatible = "rockchip,rk3568-pwm\0rockchip,rk3328-pwm";
		status = "disabled";
		reg = <0x00 0xfe6f0030 0x00 0x10>;
		phandle = <0x133>;
	};

	sata@fc000000 {
		power-domains = <0x10 0x0f>;
		phy-names = "sata-phy";
		clock-names = "sata\0pmalive\0rxoob";
		interrupts = <0x00 0x5e 0x04>;
		clocks = <0x0e 0x96 0x0e 0x97 0x0e 0x98>;
		compatible = "rockchip,rk3568-dwc-ahci\0snps,dwc-ahci";
		status = "disabled";
		phys = <0xbe 0x01>;
		reg = <0x00 0xfc000000 0x00 0x1000>;
		phandle = <0x13c>;
		ports-implemented = <0x01>;
	};

	phy@fe820000 {
		rockchip,pipe-grf = <0xad>;
		clock-names = "ref\0apb\0pipe";
		assigned-clocks = <0x1e 0x1f>;
		assigned-clock-rates = <0x5f5e100>;
		resets = <0x0e 0x1c5>;
		clocks = <0x1e 0x1f 0x0e 0x17c 0x0e 0x7f>;
		#phy-cells = <0x01>;
		compatible = "rockchip,rk3568-naneng-combphy";
		status = "okay";
		rockchip,pipe-phy-grf = <0xcc>;
		reg = <0x00 0xfe820000 0x00 0x100>;
		phandle = <0xbe>;
	};

	serial@fe6d0000 {
		reg-io-width = <0x04>;
		pinctrl-names = "default";
		pinctrl-0 = <0x99>;
		clock-names = "baudclk\0apb_pclk";
		interrupts = <0x00 0x7d 0x04>;
		clocks = <0x0e 0x13f 0x0e 0x13c>;
		compatible = "rockchip,rk3568-uart\0snps,dw-apb-uart";
		status = "disabled";
		reg = <0x00 0xfe6d0000 0x00 0x100>;
		phandle = <0x124>;
		dmas = <0x25 0x12 0x25 0x13>;
		reg-shift = <0x02>;
	};

	iommu@fe043e00 {
		clock-names = "aclk\0iface";
		interrupts = <0x00 0x94 0x04>;
		clocks = <0x0e 0xdd 0x0e 0xde>;
		#iommu-cells = <0x00>;
		compatible = "rockchip,rk3568-iommu";
		status = "okay";
		reg = <0x00 0xfe043e00 0x00 0x100 0x00 0xfe043f00 0x00 0x100>;
		phandle = <0x53>;
	};

	qos@fe138180 {
		compatible = "rockchip,rk3568-qos\0syscon";
		reg = <0x00 0xfe138180 0x00 0x20>;
		phandle = <0x3c>;
	};

	rng@fe388000 {
		compatible = "rockchip,cryptov2-rng";
		status = "okay";
		reg = <0x00 0xfe388000 0x00 0x2000>;
		phandle = <0x14d>;
	};

	nvmem@fe38c000 {
		#address-cells = <0x01>;
		#size-cells = <0x01>;
		compatible = "rockchip,rk3568-otp";
		status = "okay";
		reg = <0x00 0xfe38c000 0x00 0x4000>;
		phandle = <0x14a>;

		id@a {
			reg = <0x0a 0x10>;
			phandle = <0x14b>;
		};
	};

	pwm@fe6f0020 {
		pinctrl-names = "default";
		pinctrl-0 = <0xa7>;
		clock-names = "pwm\0pclk";
		clocks = <0x0e 0x15d 0x0e 0x15c>;
		#pwm-cells = <0x03>;
		compatible = "rockchip,rk3568-pwm\0rockchip,rk3328-pwm";
		status = "disabled";
		reg = <0x00 0xfe6f0020 0x00 0x10>;
		phandle = <0x132>;
	};

	pdm@fe440000 {
		pinctrl-names = "default";
		pinctrl-0 = <0x76 0x77 0x78 0x79 0x7a 0x7b>;
		clock-names = "pdm_clk\0pdm_hclk";
		resets = <0x0e 0x58>;
		interrupts = <0x00 0x4c 0x04>;
		clocks = <0x0e 0x5a 0x0e 0x59>;
		dma-names = "rx";
		#sound-dai-cells = <0x00>;
		compatible = "rockchip,rk3568-pdm";
		status = "disabled";
		reg = <0x00 0xfe440000 0x00 0x1000>;
		phandle = <0x10f>;
		dmas = <0x65 0x09>;
		reset-names = "pdm-m";
	};

	usb@fcc00000 {
		power-domains = <0x10 0x0f>;
		phy-names = "usb2-phy";
		clock-names = "ref_clk\0suspend_clk\0bus_clk";
		phy_type = "utmi_wide";
		snps,dis_u2_susphy_quirk;
		resets = <0x0e 0x94>;
		interrupts = <0x00 0xa9 0x04>;
		clocks = <0x0e 0xa6 0x0e 0xa7 0x0e 0xa5>;
		maxmium-speed = "high-speed";
		extcon = <0x13>;
		compatible = "rockchip,rk3568-dwc3\0snps,dwc3";
		status = "okay";
		phys = <0x12>;
		reg = <0x00 0xfcc00000 0x00 0x400000>;
		phandle = <0xe0>;
		dr_mode = "host";
	};

	pwm@fe6f0010 {
		pinctrl-names = "default";
		pinctrl-0 = <0xa6>;
		clock-names = "pwm\0pclk";
		clocks = <0x0e 0x15d 0x0e 0x15c>;
		#pwm-cells = <0x03>;
		compatible = "rockchip,rk3568-pwm\0rockchip,rk3328-pwm";
		status = "disabled";
		reg = <0x00 0xfe6f0010 0x00 0x10>;
		phandle = <0x131>;
	};

	qos@fe158000 {
		compatible = "rockchip,rk3568-qos\0syscon";
		reg = <0x00 0xfe158000 0x00 0x20>;
		phandle = <0x32>;
	};

	vop@fe040000 {
		power-domains = <0x10 0x09>;
		iommus = <0x53>;
		clock-names = "aclk\0hclk\0dclk_vp0\0dclk_vp1\0dclk_vp2";
		reg-names = "vop\0gamma-lut";
		assigned-clocks = <0x0e 0xdf 0x0e 0xe0>;
		assigned-clock-parents = <0x1e 0x02 0x0e 0x05>;
		interrupts = <0x00 0x94 0x04>;
		clocks = <0x0e 0xdd 0x0e 0xde 0x0e 0xdf 0x0e 0xe0 0x0e 0xe1>;
		compatible = "rockchip,rk3568-vop";
		status = "okay";
		rockchip,grf = <0x1c>;
		reg = <0x00 0xfe040000 0x00 0x3000 0x00 0xfe044000 0x00 0x1000>;
		phandle = <0xf9>;

		ports {
			#address-cells = <0x01>;
			#size-cells = <0x00>;
			phandle = <0x05>;

			port@0 {
				#address-cells = <0x01>;
				#size-cells = <0x00>;
				reg = <0x00>;
				phandle = <0xfa>;

				endpoint@2 {
					remote-endpoint = <0x54>;
					reg = <0x02>;
					phandle = <0x5c>;
				};
			};

			port@1 {
				#address-cells = <0x01>;
				#size-cells = <0x00>;
				reg = <0x01>;
				phandle = <0xfb>;
			};

			port@2 {
				#address-cells = <0x01>;
				#size-cells = <0x00>;
				reg = <0x02>;
				phandle = <0xfc>;
			};
		};
	};

	serial@fe660000 {
		reg-io-width = <0x04>;
		pinctrl-names = "default";
		pinctrl-0 = <0x92>;
		clock-names = "baudclk\0apb_pclk";
		interrupts = <0x00 0x76 0x04>;
		clocks = <0x0e 0x123 0x0e 0x120>;
		compatible = "rockchip,rk3568-uart\0snps,dw-apb-uart";
		status = "okay";
		reg = <0x00 0xfe660000 0x00 0x100>;
		bootph-pre-ram;
		phandle = <0x11d>;
		dmas = <0x25 0x04 0x25 0x05>;
		reg-shift = <0x02>;
	};

	dma-controller@fe530000 {
		clock-names = "apb_pclk";
		interrupts = <0x00 0x0e 0x04 0x00 0x0d 0x04>;
		clocks = <0x0e 0x10d>;
		arm,pl330-periph-burst;
		compatible = "arm,pl330\0arm,primecell";
		reg = <0x00 0xfe530000 0x00 0x4000>;
		phandle = <0x25>;
		#dma-cells = <0x01>;
	};

	pwm@fe6f0000 {
		pinctrl-names = "default";
		pinctrl-0 = <0xa5>;
		clock-names = "pwm\0pclk";
		clocks = <0x0e 0x15d 0x0e 0x15c>;
		#pwm-cells = <0x03>;
		compatible = "rockchip,rk3568-pwm\0rockchip,rk3328-pwm";
		status = "disabled";
		reg = <0x00 0xfe6f0000 0x00 0x10>;
		phandle = <0x130>;
	};

	memory {
		device_type = "memory";
		reg = <0x00 0x200000 0x00 0x7fe00000>;
	};

	qos@fe198000 {
		compatible = "rockchip,rk3568-qos\0syscon";
		reg = <0x00 0xfe198000 0x00 0x20>;
		phandle = <0x39>;
	};

	spi@fe300000 {
		u-boot,spl-sfc-no-dma;
		pinctrl-names = "default";
		#address-cells = <0x01>;
		pinctrl-0 = <0x64>;
		clock-names = "clk_sfc\0hclk_sfc";
		interrupts = <0x00 0x65 0x04>;
		clocks = <0x0e 0x78 0x0e 0x76>;
		#size-cells = <0x00>;
		compatible = "rockchip,sfc";
		status = "okay";
		reg = <0x00 0xfe300000 0x00 0x4000>;
		bootph-pre-ram;
		phandle = <0x109>;

		flash@0 {
			spi-tx-bus-width = <0x01>;
			spi-max-frequency = <0x47868c0>;
			spi-rx-bus-width = <0x04>;
			compatible = "spi-nand";
			reg = <0x00>;
			bootph-pre-ram;
			phandle = <0x10a>;
		};

		flash@1 {
			spi-tx-bus-width = <0x01>;
			spi-max-frequency = <0x5f5e100>;
			spi-rx-bus-width = <0x04>;
			label = "sfc_nor";
			compatible = "jedec,spi-nor";
			reg = <0x00>;
			bootph-pre-ram;
			phandle = <0x10b>;
		};
	};

	mmc@fe310000 {
		clock-names = "core\0bus\0axi\0block\0timer";
		assigned-clocks = <0x0e 0x7b 0x0e 0x7d>;
		mmc-hs200-1_8v;
		bus-width = <0x08>;
		non-removable;
		assigned-clock-rates = <0xbebc200 0x16e3600>;
		interrupts = <0x00 0x13 0x04>;
		clocks = <0x0e 0x7c 0x0e 0x7a 0x0e 0x79 0x0e 0x7b 0x0e 0x7d>;
		compatible = "rockchip,rk3568-dwcmshc";
		status = "okay";
		reg = <0x00 0xfe310000 0x00 0x10000>;
		bootph-pre-ram;
		phandle = <0x10c>;
		max-frequency = <0xbebc200>;
	};

	usb2phy@fe8a0000 {
		rockchip,usbgrf = <0xb0>;
		clock-output-names = "clk_usbphy0_480m";
		clock-names = "phyclk";
		interrupts = <0x00 0x87 0x04>;
		clocks = <0x1e 0x13>;
		#clock-cells = <0x00>;
		compatible = "rockchip,rk3568-usb2phy";
		status = "okay";
		reg = <0x00 0xfe8a0000 0x00 0x10000>;
		phandle = <0x13>;

		host-port {
			phy-supply = <0xb1>;
			#phy-cells = <0x00>;
			status = "okay";
			phandle = <0x14>;
		};

		otg-port {
			phy-supply = <0xb2>;
			#phy-cells = <0x00>;
			status = "okay";
			phandle = <0x12>;
		};
	};

	crypto@fe380000 {
		clock-names = "sclk_crypto\0apkclk_crypto";
		clocks = <0x0e 0x6c 0x0e 0x6d>;
		clock-frequency = <0x8f0d180 0x11e1a300>;
		compatible = "rockchip,rk3568-crypto";
		status = "okay";
		reg = <0x00 0xfe380000 0x00 0x4000>;
		phandle = <0x14c>;
	};

	pcie@fe270000 {
		power-domains = <0x10 0x0f>;
		#address-cells = <0x03>;
		phy-names = "pcie-phy";
		bus-range = <0x00 0x0f>;
		clock-names = "aclk_mst\0aclk_slv\0aclk_dbi\0pclk\0aux";
		reg-names = "dbi\0apb\0config";
		num-ob-windows = <0x02>;
		resets = <0x0e 0xb1>;
		interrupts = <0x00 0xa0 0x04 0x00 0x9f 0x04 0x00 0x9e 0x04 0x00 0x9d 0x04 0x00 0x9c 0x04>;
		clocks = <0x0e 0x88 0x0e 0x89 0x0e 0x8a 0x0e 0x8b 0x0e 0x8c>;
		interrupt-map = <0x00 0x00 0x00 0x01 0xc0 0x00 0x00 0x00 0x00 0x02 0xc0 0x01 0x00 0x00 0x00 0x03 0xc0 0x02 0x00 0x00 0x00 0x04 0xc0 0x03>;
		#size-cells = <0x02>;
		max-link-speed = <0x03>;
		device_type = "pci";
		interrupt-map-mask = <0x00 0x00 0x00 0x07>;
		num-lanes = <0x01>;
		compatible = "rockchip,rk3568-pcie";
		ranges = <0x1000000 0x00 0xf2100000 0x00 0xf2100000 0x00 0x100000 0x2000000 0x00 0xf2200000 0x00 0xf2200000 0x00 0x1e00000 0x3000000 0x00 0x40000000 0x03 0x40000000 0x00 0x40000000>;
		msi-map = <0x00 0x01 0x1000 0x1000>;
		#interrupt-cells = <0x01>;
		status = "disabled";
		interrupt-names = "sys\0pmc\0msg\0legacy\0err";
		phys = <0xc1>;
		reg = <0x03 0xc0400000 0x00 0x400000 0x00 0xfe270000 0x00 0x10000 0x00 0xf2000000 0x00 0x100000>;
		linux,pci-domain = <0x01>;
		phandle = <0x13d>;
		reset-names = "pipe";
		num-ib-windows = <0x06>;

		legacy-interrupt-controller {
			#address-cells = <0x00>;
			interrupts = <0x00 0x9d 0x01>;
			interrupt-parent = <0x01>;
			#interrupt-cells = <0x01>;
			phandle = <0xc0>;
			interrupt-controller;
		};
	};
};
